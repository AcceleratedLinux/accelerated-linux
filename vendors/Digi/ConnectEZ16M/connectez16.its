## vendors/Digi/ConnectEZ16M/connectez16.its
```
/dts-v1/;

/ {
	description = "U-Boot fitImage for Digi ConnectEZ-16";
	#address-cells = <1>;

	images {
		kernel@1 {
			description = "Linux kernel";
			data = /incbin/("kernel.gz");
			type = "kernel";
			arch = "arm64";
			os = "linux";
			compression = "gzip";
			load = <0x80000000>;
			entry = <0x80000000>;
			hash@1 {
				algo = "sha1";
			};
		};

		fdt@connectez16.dtb {
			description = "Flattened Device Tree blob";
			data = /incbin/("connectez16m.dtb");
			type = "flat_dt";
			arch = "arm64";
			compression = "none";
			load = <0x84000000>;
			hash@1 {
				algo = "sha1";
			};
		};
	};

	configurations {
		default = "conf@connectez16.dtb";
		conf@connectez16.dtb {
			description = "1 Linux kernel, FDT blob";
			kernel = "kernel@1";
			fdt = "fdt@connectez16.dtb";
			hash@1 {
				algo = "sha1";
			};
		};
	};
};
```

## vendors/Digi/ConnectEZ4WS/connectez4ws.its
```
/dts-v1/;

/ {
	description = "U-Boot fitImage for Digi ConnectEZ-4 WS";
	#address-cells = <1>;

	images {
		kernel-1 {
			description = "Linux kernel";
			data = /incbin/("kernel.gz");
			type = "kernel";
			arch = "arm64";
			os = "linux";
			compression = "gzip";
			load = <0x80000000>;
			entry = <0x80000000>;
			hash-1 {
				algo = "sha1";
			};
		};

		fdt-connectez4ws.dtb {
			description = "Flattened Device Tree blob";
			data = /incbin/("connectez4ws.dtb");
			type = "flat_dt";
			arch = "arm64";
			compression = "none";
			load = <0x84000000>;
			hash-1 {
				algo = "sha1";
			};
		};
	};

	configurations {
		default = "conf-connectez4ws.dtb";
		conf-connectez4ws.dtb {
			description = "1 Linux kernel, FDT blob";
			kernel = "kernel-1";
			fdt = "fdt-connectez4ws.dtb";
			hash-1 {
				algo = "sha1";
			};
		};
	};
};
```

## vendors/Digi/ConnectEZ8IO/connectez8-initrd.its
```
/dts-v1/;

/ {
	description = "Digi/ConnectEZ-8IO";
	address-cells = <1>;

	images {
		kernel@1 {
			description = "Linux kernel";
			data = /incbin/("kernel.gz");
			type = "kernel";
			arch = "arm64";
			os = "linux";
			compression = "gzip";
			load = <0x80000000>;
			entry = <0x80000000>;
			hash@2 {
				algo = "sha1";
			};
		};

		ramdisk@1 {
			description = "Linux ramdisk";
			data = /incbin/("rootfs.bin");
			type = "ramdisk";
			arch = "arm64";
			os = "linux";
			compression = "none";
			hash@2 {
				algo = "sha1";
			};
		};

		fdt@1 {
			description = "Flattened Device Tree blob";
			data = /incbin/("connectez8io.dtb");
			type = "flat_dt";
			arch = "arm64";
			compression = "none";
			load = <0x88000000>;
			hash@2 {
				algo = "sha1";
			};
		};
	};

	configurations {
		default = "config@1";
		config@1 {
			description = "Digi/ConnectEZ-8IO image";
			kernel = "kernel@1";
			ramdisk = "ramdisk@1";
			fdt = "fdt@1";
		};
	};
};
```

## vendors/Digi/ConnectEZ8M/connectez8.its
```
/dts-v1/;

/ {
	description = "U-Boot fitImage for Digi ConnectEZ-8M";
	#address-cells = <1>;

	images {
		kernel@1 {
			description = "Linux kernel";
			data = /incbin/("kernel.gz");
			type = "kernel";
			arch = "arm64";
			os = "linux";
			compression = "gzip";
			load = <0x80000000>;
			entry = <0x80000000>;
			hash@1 {
				algo = "sha1";
			};
		};

		fdt@connectez.dtb {
			description = "Flattened Device Tree blob";
			data = /incbin/("connectez8m.dtb");
			type = "flat_dt";
			arch = "arm64";
			compression = "none";
			load = <0x84000000>;
			hash@1 {
				algo = "sha1";
			};
		};
	};

	configurations {
		default = "conf@connectez.dtb";
		conf@connectez.dtb {
			description = "1 Linux kernel, FDT blob";
			kernel = "kernel@1";
			fdt = "fdt@connectez.dtb";
			hash@1 {
				algo = "sha1";
			};
		};
	};
};
```

## vendors/Digi/EX50/ex50-initrd.its
```
/dts-v1/;

/ {
	description = "Digi/EX50";
	address-cells = <1>;

	images {
		kernel_1 {
			description = "Linux kernel";
			data = /incbin/("kernel");
			type = "kernel";
			arch = "arm64";
			os = "linux";
			compression = "none";
			load = <0x41000000>;
			entry = <0x41000000>;
			hash_2 {
				algo = "sha1";
			};
		};

		ramdisk_1 {
			description = "Linux ramdisk";
			data = /incbin/("rootfs.bin");
			type = "ramdisk";
			arch = "arm64";
			os = "linux";
			compression = "none";
			hash_2 {
				algo = "sha1";
			};
		};

		fdt_1 {
			description = "Flattened Device Tree blob";
			data = /incbin/("ex50.dtb");
			type = "flat_dt";
			arch = "arm64";
			compression = "none";
			hash_2 {
				algo = "sha1";
			};
		};
	};

	configurations {
		default = "config_1";
		config_1 {
			description = "Digi/EX50 image";
			kernel = "kernel_1";
			ramdisk = "ramdisk_1";
			fdt = "fdt_1";
		};
	};
};
```

## vendors/Digi/EX50/ex50.its
```
/dts-v1/;

/ {
	description = "Digi/EX50";
	#address-cells = <1>;

	images {
		kernel_1 {
			description = "Linux kernel";
			data = /incbin/("kernel.gz");
			type = "kernel";
			arch = "arm64";
			os = "linux";
			compression = "gzip";
			load = <0x41000000>;
			entry = <0x41000000>;
			hash_1 {
				algo = "sha1";
			};
		};

		fdt_1 {
			description = "Flattened Device Tree blob";
			data = /incbin/("ex50.dtb");
			type = "flat_dt";
			arch = "arm64";
			compression = "none";
			hash_1 {
				algo = "sha1";
			};
		};
	};

	configurations {
		default = "config_cp01-c1";
		config_cp01-c1 {
			description = "Digi/EX50 image";
			kernel = "kernel_1";
			fdt = "fdt_1";
			hash_1 {
				algo = "sha1";
			};
		};
	};
};
```

## vendors/Digi/IX40/ix40.its
```
/dts-v1/;

/ {
	description = "Digi/IX40";
	#address-cells = <1>;

	images {
		kernel {
			description = "Linux kernel";
			data = /incbin/("kernel.gz");
			type = "kernel";
			arch = "arm64";
			os = "linux";
			compression = "gzip";
			load = <0x40400000>;
			entry = <0x40400000>;
			hash-1 {
				algo = "sha1";
			};
		};

		fdt {
			description = "Flattened Device Tree blob";
			data = /incbin/("imx8mp-ix40.dtb");
			type = "flat_dt";
			arch = "arm64";
			compression = "none";
			load = <0x4f000000>;
			hash-1 {
				algo = "sha1";
			};
		};
	};

	configurations {
		default = "config";
		config {
			description = "Digi/IX40 image";
			kernel = "kernel";
			fdt = "fdt";
		};
	};
};
```

## vendors/Digi/TX40/tx40-evt-initrd.its
```
/dts-v1/;

/ {
	description = "Digi/TX40 EVT";
	address-cells = <1>;

	images {
		kernel-1 {
			description = "Linux kernel";
			data = /incbin/("kernel.gz");
			type = "kernel";
			arch = "arm64";
			os = "linux";
			compression = "gzip";
			load = <0x84080000>;
			entry = <0x84080000>;
			hash-2 {
				algo = "sha1";
			};
		};

		ramdisk-1 {
			description = "Linux ramdisk";
			data = /incbin/("rootfs.bin");
			type = "ramdisk";
			arch = "arm64";
			os = "linux";
			compression = "none";
			hash-2 {
				algo = "sha1";
			};
		};

		fdt-1 {
			description = "Flattened Device Tree blob";
			data = /incbin/("fsl-ls1028a-tx40-evt.dtb");
			type = "flat_dt";
			arch = "arm64";
			compression = "none";
			load = <0x88000000>;
			hash-2 {
				algo = "sha1";
			};
		};
	};

	configurations {
		default = "config-1";
		config-1 {
			description = "Digi/TX40 EVT image";
			kernel = "kernel-1";
			ramdisk = "ramdisk-1";
			fdt = "fdt-1";
		};
	};
};
```

## vendors/Digi/TX40/tx40-evt.its
```
/dts-v1/;

/ {
	description = "U-Boot fitImage for Digi TX40 EVT";
	#address-cells = <1>;

	images {
		kernel-1 {
			description = "Linux kernel";
			data = /incbin/("kernel.gz");
			type = "kernel";
			arch = "arm64";
			os = "linux";
			compression = "gzip";
			load = <0x84080000>;
			entry = <0x84080000>;
			hash-1 {
				algo = "sha1";
			};
		};

		fdt-fsl-ls1028a-tx40-evt.dtb {
			description = "Flattened Device Tree blob";
			data = /incbin/("fsl-ls1028a-tx40-evt.dtb");
			type = "flat_dt";
			arch = "arm64";
			compression = "none";
			load = <0x88000000>;
			hash-1 {
				algo = "sha1";
			};
		};
	};

	configurations {
		default = "conf-fsl-ls1028a-tx40-evt.dtb";
		conf-fsl-ls1028a-tx40-evt.dtb {
			description = "1 Linux kernel, FDT blob";
			kernel = "kernel-1";
			fdt = "fdt-fsl-ls1028a-tx40-evt.dtb";
			hash-1 {
				algo = "sha1";
			};
		};
	};
};
```
