## linux/drivers/net/wireless/ath/Kconfig
```kconfig
# SPDX-License-Identifier: ISC
config ATH_COMMON
	tristate

config WLAN_VENDOR_ATH
	bool "Atheros/Qualcomm devices"
	default y
	help
	  If you have a wireless card belonging to this class, say Y.

	  Note that the answer to this question doesn't directly affect the
	  kernel: saying N will just cause the configurator to skip all the
	  questions about these cards. If you say Y, you will be asked for
	  your specific card in the following questions.

	  For more information and documentation on this module you can visit:

	  https://wireless.wiki.kernel.org/en/users/Drivers/ath

	  For information on all Atheros wireless drivers visit:

	  https://wireless.wiki.kernel.org/en/users/Drivers/Atheros

if WLAN_VENDOR_ATH

config ATH_DEBUG
	bool "Atheros wireless debugging"
	help
	  Say Y, if you want to debug atheros wireless drivers.
	  Right now only ath9k makes use of this.

config ATH_TRACEPOINTS
	bool "Atheros wireless tracing"
	depends on ATH_DEBUG
	depends on EVENT_TRACING
	help
	  This option enables tracepoints for atheros wireless drivers.
	  Currently, ath9k makes use of this facility.

config ATH_REG_DYNAMIC_USER_REG_HINTS
	bool "Atheros dynamic user regulatory hints"
	depends on CFG80211_CERTIFICATION_ONUS
	default n
	help
	  Say N. This should only be enabled in countries where
	  this feature is explicitly allowed and only on cards that
	  specifically have been tested for this.

config ATH_REG_DYNAMIC_USER_CERT_TESTING
	bool "Atheros dynamic user regulatory testing"
	depends on ATH_REG_DYNAMIC_USER_REG_HINTS && CFG80211_CERTIFICATION_ONUS
	default n
	help
	  Say N. This should only be enabled on systems
	  undergoing certification testing.


config ATH_REG_NO_FORCED_RADAR
	bool "Atheros regulatory radar/IR override"
	depends on CFG80211_CERTIFICATION_ONUS
	default n
	help
	  Do not force radar or IR flags channels. This option should be
	  enabled with the intent to have userspace manage the regulatory
	  domain through e.g. CRDA.

choice
	prompt "Atheros force regulatory domain"
	depends on CFG80211_CERTIFICATION_ONUS
	default ATH_REG_FORCE_NONE

config ATH_REG_FORCE_NONE
	bool
	prompt "No forced regulatory domain"
	help
	  Select this option to respect the country code read from the
	  radio's EEPROM.

config ATH_REG_FORCE_UNRESTRICTED
	bool
	prompt "Unrestricted regulatory domain"
	help
	  Select this option to ignore the country code from the EEPROM
	  and use an unrestricted "global" regulatory domain.
	  This option should be enabled with the intent to have userspace
	  manage the regulatory domain through e.g. CRDA.

config ATH_REG_FORCE_DEFAULT
	bool
	prompt "Default regulatory domain"
	help
	  Select this option to pretend the country code read from the
	  EEPROM was 0x00 which corresponds to the "default" country
	  which is hardcoded in the driver as the UNITED STATES.

endchoice

source "drivers/net/wireless/ath/ath5k/Kconfig"
source "drivers/net/wireless/ath/ath9k/Kconfig"
source "drivers/net/wireless/ath/carl9170/Kconfig"
source "drivers/net/wireless/ath/ath6kl/Kconfig"
source "drivers/net/wireless/ath/ar5523/Kconfig"
source "drivers/net/wireless/ath/wil6210/Kconfig"
source "drivers/net/wireless/ath/ath10k/Kconfig"
source "drivers/net/wireless/ath/wcn36xx/Kconfig"
source "drivers/net/wireless/ath/ath11k/Kconfig"
source "drivers/net/wireless/ath/ath12k/Kconfig"

endif
```

## musl/Kconfig
```kconfig
menu "musl options"
comment "musl options apply only when CONFIG_DEFAULTS_LIBC_MUSL=y"

config LIB_MUSL_HAS_TZ_FILE
	bool "Has TZ file"
	help
		Read a Posix timezone formatted string from a file if the TZ
		environment variable is not set.
		This overrides the use of /etc/localtime.

config LIB_MUSL_TZ_FILE_PATH
	string "TZ file path"
	depends on LIB_MUSL_HAS_TZ_FILE
	default "/etc/TZ"
	help
		The path to the file containing a Posix timezone formatted string,
		used when the TZ environment variable is not set.
		This overrides the use of /etc/localtime.

endmenu
```

## user/ModemManager/Kconfig
```kconfig
config USER_MODEMMANAGER
	bool 'ModemManager'
	select LIB_DBUS_GLIB
	select LIB_DBUS
	select USER_LIBQMI
	select USER_UDEV
	select USER_LIBGUDEV
	help
	  USB/Serial modem mananger.

config USER_MODEMMANAGER_ALLPLUGINS
	bool 'all plugins'
	depends on USER_MODEMMANAGER
	help
	  Install all ModemManager plugins

config USER_MODEMMANAGER_PLUGIN_ANYDATA
	bool 'plugin-anydata'
	depends on USER_MODEMMANAGER
	depends on !USER_MODEMMANAGER_ALLPLUGINS
	help
	  Install anydata plugin

config USER_MODEMMANAGER_PLUGIN_MOTOROLA
	bool 'plugin-motorola'
	depends on USER_MODEMMANAGER
	depends on !USER_MODEMMANAGER_ALLPLUGINS
	help
	  Install motorola plugin

config USER_MODEMMANAGER_PLUGIN_GENERIC
	bool 'plugin-generic'
	depends on USER_MODEMMANAGER
	depends on !USER_MODEMMANAGER_ALLPLUGINS
	help
	  Install generic plugin

config USER_MODEMMANAGER_PLUGIN_UNITAC
	bool 'plugin-unitac'
	depends on USER_MODEMMANAGER
	depends on !USER_MODEMMANAGER_ALLPLUGINS
	help
	  Install unitac plugin

config USER_MODEMMANAGER_PLUGIN_SAMSUNG
	bool 'plugin-samsung'
	depends on USER_MODEMMANAGER
	depends on !USER_MODEMMANAGER_ALLPLUGINS
	help
	  Install samsung plugin

config USER_MODEMMANAGER_PLUGIN_MBM
	bool 'plugin-mbm'
	depends on USER_MODEMMANAGER
	depends on !USER_MODEMMANAGER_ALLPLUGINS
	help
	  Install mbm plugin

config USER_MODEMMANAGER_PLUGIN_ZTE
	bool 'plugin-zte'
	depends on USER_MODEMMANAGER
	depends on !USER_MODEMMANAGER_ALLPLUGINS
	help
	  Install zte plugin

config USER_MODEMMANAGER_PLUGIN_PANTECH
	bool 'plugin-pantech'
	depends on USER_MODEMMANAGER
	depends on !USER_MODEMMANAGER_ALLPLUGINS
	help
	  Install pantech plugin

config USER_MODEMMANAGER_PLUGIN_NOKIA_ICERA
	bool 'plugin-nokia-icera'
	depends on USER_MODEMMANAGER
	depends on !USER_MODEMMANAGER_ALLPLUGINS
	help
	  Install nokia-icera plugin

config USER_MODEMMANAGER_PLUGIN_NOVATEL_LTE
	bool 'plugin-novatel-lte'
	depends on USER_MODEMMANAGER
	depends on !USER_MODEMMANAGER_ALLPLUGINS
	help
	  Install novatel-lte plugin

config USER_MODEMMANAGER_PLUGIN_WAVECOM
	bool 'plugin-wavecom'
	depends on USER_MODEMMANAGER
	depends on !USER_MODEMMANAGER_ALLPLUGINS
	help
	  Install wavecom plugin

config USER_MODEMMANAGER_PLUGIN_NOVATEL
	bool 'plugin-novatel'
	depends on USER_MODEMMANAGER
	depends on !USER_MODEMMANAGER_ALLPLUGINS
	help
	  Install novatel plugin

config USER_MODEMMANAGER_PLUGIN_GOBI
	bool 'plugin-gobi'
	depends on USER_MODEMMANAGER
	depends on !USER_MODEMMANAGER_ALLPLUGINS
	help
	  Install gobi plugin

config USER_MODEMMANAGER_PLUGIN_CINTERION
	bool 'plugin-cinterion'
	depends on USER_MODEMMANAGER
	depends on !USER_MODEMMANAGER_ALLPLUGINS
	help
	  Install cinterion plugin

config USER_MODEMMANAGER_PLUGIN_LONGCHEER
	bool 'plugin-longcheer'
	depends on USER_MODEMMANAGER
	depends on !USER_MODEMMANAGER_ALLPLUGINS
	help
	  Install longcheer plugin

config USER_MODEMMANAGER_PLUGIN_OPTION
	bool 'plugin-option'
	depends on USER_MODEMMANAGER
	depends on !USER_MODEMMANAGER_ALLPLUGINS
	help
	  Install option plugin

config USER_MODEMMANAGER_PLUGIN_VIA
	bool 'plugin-via'
	depends on USER_MODEMMANAGER
	depends on !USER_MODEMMANAGER_ALLPLUGINS
	help
	  Install via plugin

config USER_MODEMMANAGER_PLUGIN_HSO
	bool 'plugin-hso'
	depends on USER_MODEMMANAGER
	depends on !USER_MODEMMANAGER_ALLPLUGINS
	help
	  Install hso plugin

config USER_MODEMMANAGER_PLUGIN_IRIDIUM
	bool 'plugin-iridium'
	depends on USER_MODEMMANAGER
	depends on !USER_MODEMMANAGER_ALLPLUGINS
	help
	  Install iridium plugin

config USER_MODEMMANAGER_PLUGIN_SIERRA
	bool 'plugin-sierra'
	depends on USER_MODEMMANAGER
	depends on !USER_MODEMMANAGER_ALLPLUGINS
	help
	  Install sierra plugin

config USER_MODEMMANAGER_PLUGIN_NOKIA
	bool 'plugin-nokia'
	depends on USER_MODEMMANAGER
	depends on !USER_MODEMMANAGER_ALLPLUGINS
	help
	  Install nokia plugin

config USER_MODEMMANAGER_PLUGIN_HUAWEI
	bool 'plugin-huawei'
	depends on USER_MODEMMANAGER
	depends on !USER_MODEMMANAGER_ALLPLUGINS
	help
	  Install huawei plugin

config USER_MODEMMANAGER_PLUGIN_X22X
	bool 'plugin-x22x'
	depends on USER_MODEMMANAGER
	depends on !USER_MODEMMANAGER_ALLPLUGINS
	help
	  Install x22x plugin

config USER_MODEMMANAGER_PLUGIN_SIMTECH
	bool 'plugin-simtech'
	depends on USER_MODEMMANAGER
	depends on !USER_MODEMMANAGER_ALLPLUGINS
	help
	  Install simtech plugin

config USER_MODEMMANAGER_PLUGIN_LINKTOP
	bool 'plugin-linktop'
	depends on USER_MODEMMANAGER
	depends on !USER_MODEMMANAGER_ALLPLUGINS
	help
	  Install linktop plugin

config USER_MODEMMANAGER_PLUGIN_ALTAIRLTE
	bool 'plugin-altairlte'
	depends on USER_MODEMMANAGER
	depends on !USER_MODEMMANAGER_ALLPLUGINS
	help
	  Install altair-lte plugin

config USER_MODEMMANAGER_PLUGIN_BROADMOBI
	bool 'plugin-broadmobi'
	depends on USER_MODEMMANAGER
	depends on !USER_MODEMMANAGER_ALLPLUGINS
	help
	  Install broadmobi plugin

config USER_MODEMMANAGER_PLUGIN_DELL
	bool 'plugin-dell'
	depends on USER_MODEMMANAGER
	depends on !USER_MODEMMANAGER_ALLPLUGINS
	help
	  Install dell plugin

config USER_MODEMMANAGER_PLUGIN_DLINK
	bool 'plugin-dlink'
	depends on USER_MODEMMANAGER
	depends on !USER_MODEMMANAGER_ALLPLUGINS
	help
	  Install dlink plugin

config USER_MODEMMANAGER_PLUGIN_ERICSSONMBM
	bool 'plugin-ericssonmbm'
	depends on USER_MODEMMANAGER
	depends on !USER_MODEMMANAGER_ALLPLUGINS
	help
	  Install ericsson-mbm plugin

config USER_MODEMMANAGER_PLUGIN_FIBOCOM
	bool 'plugin-fibocom'
	depends on USER_MODEMMANAGER
	depends on !USER_MODEMMANAGER_ALLPLUGINS
	help
	  Install fibocom plugin

config USER_MODEMMANAGER_PLUGIN_FOXCONN
	bool 'plugin-foxconn'
	depends on USER_MODEMMANAGER
	depends on !USER_MODEMMANAGER_ALLPLUGINS
	help
	  Install foxconn plugin

config USER_MODEMMANAGER_PLUGIN_HAIER
	bool 'plugin-haier'
	depends on USER_MODEMMANAGER
	depends on !USER_MODEMMANAGER_ALLPLUGINS
	help
	  Install haier plugin

config USER_MODEMMANAGER_PLUGIN_MTK
	bool 'plugin-mtk'
	depends on USER_MODEMMANAGER
	depends on !USER_MODEMMANAGER_ALLPLUGINS
	help
	  Install mtk plugin

config USER_MODEMMANAGER_PLUGIN_OPTIONHSO
	bool 'plugin-optionhso'
	depends on USER_MODEMMANAGER
	depends on !USER_MODEMMANAGER_ALLPLUGINS
	help
	  Install option-hso plugin

config USER_MODEMMANAGER_PLUGIN_QUECTEL
	bool 'plugin-quectel'
	depends on USER_MODEMMANAGER
	depends on !USER_MODEMMANAGER_ALLPLUGINS
	help
	  Install quectel plugin

config USER_MODEMMANAGER_PLUGIN_SIERRALEGACY
	bool 'plugin-sierralegacy'
	depends on USER_MODEMMANAGER
	depends on !USER_MODEMMANAGER_ALLPLUGINS
	help
	  Install sierry-legacy plugin

config USER_MODEMMANAGER_PLUGIN_TELIT
	bool 'plugin-telit'
	depends on USER_MODEMMANAGER
	depends on !USER_MODEMMANAGER_ALLPLUGINS
	help
	  Install telit plugin

config USER_MODEMMANAGER_PLUGIN_THURAYA
	bool 'plugin-thuraya'
	depends on USER_MODEMMANAGER
	depends on !USER_MODEMMANAGER_ALLPLUGINS
	help
	  Install thuraya plugin

config USER_MODEMMANAGER_PLUGIN_TPLINK
	bool 'plugin-tplink'
	depends on USER_MODEMMANAGER
	depends on !USER_MODEMMANAGER_ALLPLUGINS
	help
	  Install tplink plugin

config USER_MODEMMANAGER_PLUGIN_UBLOX
	bool 'plugin-ublox'
	depends on USER_MODEMMANAGER
	depends on !USER_MODEMMANAGER_ALLPLUGINS
	help
	  Install ublox plugin
```

## user/aircrack-ng/Kconfig
```kconfig
config USER_AIRCRACK_NG
	bool "aircrack-ng"
	select LIB_INSTALL_LIBSTDCPLUS
	help
		aircrack-ng is a complete suite of tools to assess WiFi network security.
config USER_AIRCRACK_FULL_INSTALL
	bool "install all aircrack applications/files"
	depends on USER_AIRCRACK_NG
	help
		aircrack full install
config USER_AIRCRACK_NG_AIRODUMP
	bool "airodump"
	depends on USER_AIRCRACK_NG
	help
		airodump module for wifi scanner
config USER_AIRCRACK_NG_OSDEP
	bool "libaircrack-osdep"
	depends on USER_AIRCRACK_NG
	help
		aircrack library needed by airodump
```

## user/apparmor/Kconfig
```kconfig
config USER_APPARMOR
        bool "AppArmor"
        default n
        help
          Mandatory Access Control (MAC) system which is a kernel (LSM)
          enhancement to confine programs to a limited set of resources.

config USER_APPARMOR_FULL_INSTALL
        bool "AppArmor full install"
        depends on USER_APPARMOR
        default n
        help
          Do a full default apparmor install to the romfs.
```

## user/arptables/Kconfig
```kconfig
config USER_ARPTABLES_ARPTABLES
	bool "arptables"
	help
	  Arptables is used to set up, maintain, and inspect the tables of ARP
	  packet filter rules in the Linux kernel.
```

## user/ath11k-firmware/Kconfig
```kconfig
config USER_ATH11K_FIRMWARE
        bool "ath11k-firmware"
        help
          ath11k firmware

config USER_ATH11K_FIRMWARE_COMPEX
        bool "Install firmware for Compex WLE3002HX"
        depends on USER_ATH11K_FIRMWARE

config USER_ATH11K_FIRMWARE_SPARKLAN_QCN9074
        bool "Install firmware for SparkLan WPEQ-405AX"
        depends on USER_ATH11K_FIRMWARE

config USER_ATH11K_FIRMWARE_SPARKLAN_WCN6855
        bool "Install firmware for SparkLan WNFQ-269AX(BT)"
        depends on USER_ATH11K_FIRMWARE

config USER_ATH11K_FIRMWARE_VOXMICRO
        bool "Install firmware for Voxmicro E63W"
        depends on USER_ATH11K_FIRMWARE
```

## user/bash/Kconfig
```kconfig
config USER_BASH_BASH
	bool "bash"
	help
	  The Bourne-Again Shell. (large)
	select LIB_TERMCAP
	select LIB_TERMCAP_SHARED
```

## user/bind/Kconfig
```kconfig
config USER_BIND
       bool "bind"
       help
         ISC BIND DNS nameserver/utils.

config USER_BIND_FULL_INSTALL
       bool "install all bind applications/files"
       depends on USER_BIND
       help
         ISC BIND nsupdate command.

config USER_BIND_NSUPDATE
       bool "nsupdate"
       depends on USER_BIND && !USER_BIND_FULL_INSTALL
       help
         ISC BIND nsupdate command.

config USER_BIND_DELV
       bool "delv"
       depends on USER_BIND && !USER_BIND_FULL_INSTALL
       help
         ISC BIND delv command.

config USER_BIND_MDIG
       bool "mdig"
       depends on USER_BIND && !USER_BIND_FULL_INSTALL
       help
         ISC BIND mdig command.

config USER_BIND_ARPANAME
       bool "arpaname"
       depends on USER_BIND && !USER_BIND_FULL_INSTALL
       help
         ISC BIND arpaname command.

config USER_BIND_HOST
       bool "host"
       depends on USER_BIND && !USER_BIND_FULL_INSTALL
       help
         ISC BIND host command.

config USER_BIND_DIG
       bool "dig"
       depends on USER_BIND && !USER_BIND_FULL_INSTALL
       help
         ISC BIND dig command.

config USER_BIND_NSLOOKUP
       bool "nslookup"
       depends on USER_BIND && !USER_BIND_FULL_INSTALL
       help
         ISC BIND nslookup command.

config USER_BIND_NAMED
       bool "named"
       depends on USER_BIND && !USER_BIND_FULL_INSTALL
       help
         ISC BIND named and related files.

config USER_BIND_RNDC
       bool "rndc"
       depends on USER_BIND && !USER_BIND_FULL_INSTALL
       help
         ISC BIND rndc.

config USER_BIND_DNSSEC
       bool "dnssec tools"
       depends on USER_BIND && !USER_BIND_FULL_INSTALL
       help
         ISC BIND DNSSEC tools.
```
