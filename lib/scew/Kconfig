## lib/scew/Kconfig
```kconfig
config LIB_SCEW
	bool "Build scew"
	default n
	select LIB_EXPAT
	help
		The aim of SCEW is to provide an easy interface around the XML
		Expat parser, as well as a simple interface for creating new
		XML documents. It provides functions to load and access XML
		elements without the need to create Expat event handling
		routines every time you want to load a new XML document.
```

## lib/sysfsutils/Kconfig
```kconfig
config LIB_SYSFSUTILS
	bool

config LIB_LIBSYSFS
	select LIB_SYSFSUTILS
	bool "sysfsutils (libsysfs)"
	default n

config LIB_SYSFSUTILS_GET_DEVICE
	depends on LIB_SYSFSUTILS
	bool "get_device"
	default n

config LIB_SYSFSUTILS_GET_MODULE
	depends on LIB_SYSFSUTILS
	bool "get_module"
	default n

config LIB_SYSFSUTILS_GET_DRIVER
	depends on LIB_SYSFSUTILS
	bool "get_driver"
	default n

config LIB_SYSFSUTILS_DLIST_TEST
	depends on LIB_SYSFSUTILS
	bool "dlist_test"
	default n

config LIB_SYSFSUTILS_SYSTOOL
	depends on LIB_SYSFSUTILS
	bool "systool"
	default n
```

## lib/tinyrl/Kconfig
```kconfig
config LIB_TINYRL
    bool "tinyrl"
    help
        Library for building good CLI interfaces

config LIB_TINYRL_DISABLE_BELL
    bool "tinrl: disable bell"
    depends on LIB_TINYRL
    help
        Disable the bell
```

## linux/Documentation/devicetree/bindings/gpio/gpio-fabricated.txt
```
GPIO controller for fabricated GPIOs

The GPIO controller nodes must have child nodes, which describes the logical
GPIOs.

The sub-nodes must have either "input-gpio" or "output-gpio" property defined.

Required properties:
- compatible:		"fabricated-gpio"

- input-gpio:		input GPIO with flags (required, if output-gpio is not
			defined)
- output-gpio:		output GPIO with flags (required, if input-gpio is not
			defined)

Optional properties:
- pullup-gpio:		pull-up enable GPIO with flags
- disable-pullup:	pull-up is disabled by default

Example:
	logical-io {
		compatible = "fabricated-gpio";

		gpio01 {
			input-gpio = <&gpio4 28 GPIO_ACTIVE_HIGH>;
			output-gpio = <&gpio5 1 GPIO_ACTIVE_LOW>;
			pullup-gpio = <&gpio5 0 GPIO_ACTIVE_LOW>;
		};
	};
```

## linux/Documentation/devicetree/bindings/mfd/digi,mcu-tx54.txt
```
* Digi TX54 microcontroller multifunction device driver

Required properties:
 - compatible		: Should be "digi,mcu-tx54"
 - reg			: Specifies the I2C slave address (should be 0x78)
 - interrupt-parent	: Specifies the reference to the interrupt controller
 			  for the MCU
 - interrupts		: IRQ line information
 - interrupt-controller	: Describes the MCU is an interrupt controller with, and
 			  has its own domain
 - #interrupt-cells	: should be 1 for 1-cell format: local IRQ number

===============================================================

The TX54 MCU multifunction device has the following submodules:

Submodule			Description
---------			-----------
 - "digi,mcu-tx54-battery"	Battery voltage monitoring. startup / shutdown
 				voltage configurationg, low voltage event
 - "digi,mcu-tx54-keys"		Power off keys (ignition and power button)
 - "digi,mcu-tx54-led"		Power LED
 - "digi,mcu-tx54-poweroff"	Board power off


Required child device properties:
 - compatible		: "digi,mcu-tx54-[battery|keys|led|poweroff]

"digi,mcu-tx54-led" optional properties:
 - label		 : see Documentation/devicetree/bindings/leds/common.txt
 - default-state	 : see Documentation/devicetree/bindings/leds/common.txt
 - linux,default-trigger : see Documentation/devicetree/bindings/leds/common.txt


 Example:
 	mcu_tx54: mcu@78 {
		compatible = "digi,mcu-tx54";
		reg = <0x78>;
		interrupt-parent = <&gpio>;
		interrupts = <32 IRQ_TYPE_EDGE_RISING>;
		interrupt-controller;
		#interrupt-cells = <1>;

		mcu_pwr_led: mcu_led {
			compatible = "digi,mcu-tx54-led";
			label = "tx54:blue:power";
			linux,default-trigger = "timer";
		};

		poweroff {
			compatible = "digi,mcu-tx54-poweroff";
		};

		keys {
			compatible = "digi,mcu-tx54-keys";
		};

		battery {
			compatible = "digi,mcu-tx54-battery";
		};
	};
```

## linux/Documentation/devicetree/bindings/pinctrl/fsl,ls1012a-pinctrl.yaml
```yaml
# SPDX-License-Identifier: GPL-2.0-only OR BSD-2-Clause
%YAML 1.2
---
$id: http://devicetree.org/schemas/pinctrl/fsl,ls1012a-pinctrl.yaml#
$schema: http://devicetree.org/meta-schemas/core.yaml#

title: NXP QorIQ LS1012A pin multiplexing

maintainers:
  - Unknown

description: >
  Bindings for LS1012A pinmux control.

properties:
  compatible:
    const: fsl,ls1012a-pinctrl

  reg:
    description: Specifies the base address of the PMUXCR0 register.
    maxItems: 2

  big-endian:
    description: If present, the PMUXCR0 register is implemented in big-endian.
    type: boolean

  dcfg-regmap:
    $ref: /schemas/types.yaml#/definitions/phandle
    description:
      The phandle of the syscon node for the DCFG registers.

patternProperties:
  '^pinctrl-':
    type: object
    $ref: pinmux-node.yaml#
    unevaluatedProperties: false

    properties:
      function:
        enum: [ i2c, spi, gpio, gpio_reset ]

      groups:
        items:
          enum: [ qspi_1_grp, qspi_2_grp, qspi_3_grp ]

allOf:
  - $ref: pinctrl.yaml#

required:
  - compatible
  - reg

additionalProperties: false

examples:
  - |
    pinctrl: pinctrl@1570430 {
    	compatible = "fsl,ls1012a-pinctrl";
    	reg = <0x0 0x1570430 0x0 0x4>;
    	big-endian;
    	dcfg-regmap = <&dcfg>;
    	pinctrl_qspi_1: pinctrl-qspi-1 {
    	    groups = "qspi_1_grp";
    	    function = "spi";
    	};
    	pinctrl_qspi_2: pinctrl-qspi-2 {
    	    groups = "qspi_1_grp", "qspi_2_grp";
    	    function = "spi";
    	};
    	pinctrl_qspi_4: pinctrl-qspi-4 {
    	    groups = "qspi_1_grp", "qspi_2_grp", "qspi_3_grp";
    	    function = "spi";
    	};
    };
  - |
    qspi: quadspi@1550000 {
        compatible = "fsl,ls1021a-qspi";
        reg = <0 0x1550000 0 0x10000>;
        /* QSPI pins for buswidth 2 */
        pinctrl-names = "default";
        pinctrl-0 = <&pinctrl_qspi_2>;
        status = "okay";
    };
```

## linux/Documentation/devicetree/bindings/pinctrl/fsl,ls1046a-pinctrl.yaml
```yaml
# SPDX-License-Identifier: GPL-2.0-only OR BSD-2-Clause
%YAML 1.2
---
$id: http://devicetree.org/schemas/pinctrl/fsl,ls1046a-pinctrl.yaml#
$schema: http://devicetree.org/meta-schemas/core.yaml#

title: NXP QorIQ LS1046A pin multiplexing

maintainers:
  - Unknown

description: >
  Bindings for LS1046A pinmux control.

properties:
  compatible:
    const: fsl,ls1046a-pinctrl

  reg:
    description: >
      Specifies the base address of SCFG_RCWPMUXCR0
    maxItems: 2

  big-endian:
    description: >
      If present, the register is implemented in big endian mode.
    type: boolean

patternProperties:
  '^pinctrl-':
    type: object
    $ref: pinmux-node.yaml#
    unevaluatedProperties: false

    properties:
      function:
        enum: [ i2c, gpio, evt, usb, ftm ]

      groups:
        items:
          enum: [ L4, M4, M3, N3 ]

allOf:
  - $ref: pinctrl.yaml#

required:
  - compatible
  - reg

additionalProperties: false

examples:
  - |
    pinmux: pinmux@157040c {
      compatible = "fsl,ls1046a-pinctrl";
      reg = <0 0x157040c 0 4>;
      big-endian;
      pinctrl_i2c2: pinctrl-i2c2 {
        groups = "L4", "M4";
        function = "i2c";
      };
      pinctrl_i2c2_gpio: pinctrl-i2c2-gpio3 {
        groups = "L4", "M4";
        function = "gpio";
      };
      pinctrl_i2c3: pinctrl-i2c3 {
        groups = "M3", "N3";
        function = "i2c";
      };
      pinctrl_i2c3_gpio: pinctrl-i2c3-gpio {
        groups = "M3", "N3";
        function = "gpio";
      };
    };
```

## linux/Documentation/devicetree/bindings/rtc/maxim,max31329.yaml
```yaml
# SPDX-License-Identifier: (GPL-2.0-only OR BSD-2-Clause)
%YAML 1.2
---
$id: http://devicetree.org/schemas/rtc/maxim,max31329.yaml#
$schema: http://devicetree.org/meta-schemas/core.yaml#

title: Maxim MAX31329 Real Time Clock

maintainers:
  - Jagath Jog J <jagathjog1996@gmail.com>

allOf:
  - $ref: rtc.yaml#

properties:
  compatible:
    const: maxim,max31329

  reg:
    maxItems: 1

  "#clock-cells":
    const: 0

  clock-output-names:
    maxItems: 1

  interrupts:
    maxItems: 1

  trickle-resistor-ohms:
    enum:
      - 3000
      - 6000
      - 11000

  wakeup-source: true

  start-year: true

required:
  - compatible
  - reg

additionalProperties: false

examples:
  - |
    #include <dt-bindings/interrupt-controller/irq.h>
    i2c {
        #address-cells = <1>;
        #size-cells = <0>;

        rtc@68 {
            compatible = "maxim,max31329";
            reg = <0x68>;
            trickle-resistor-ohms = <6000>;
            #clock-cells = <0>;
        };
    };
...
```

## linux/Documentation/devicetree/bindings/watchdog/mediatek,mt7621-wdt.yaml
```yaml
# SPDX-License-Identifier: (GPL-2.0-only OR BSD-2-Clause)
%YAML 1.2
---
$id: http://devicetree.org/schemas/watchdog/mediatek,mt7621-wdt.yaml#
$schema: http://devicetree.org/meta-schemas/core.yaml#

title: Ralink Watchdog Timers

maintainers:
  - Sergio Paracuellos <sergio.paracuellos@gmail.com>

allOf:
  - $ref: watchdog.yaml#

properties:
  compatible:
    const: mediatek,mt7621-wdt

  reg:
    maxItems: 1

  mediatek,sysctl:
    $ref: /schemas/types.yaml#/definitions/phandle
    description:
      phandle to system controller 'sysc' syscon node which
      controls system registers

required:
  - compatible
  - reg

additionalProperties: true
  - mt7621,register-reset-handler: If property is present, watchdog timer will be
				   registered as reset handler

examples:
  - |
    watchdog@100 {
        compatible = "mediatek,mt7621-wdt";
        reg = <0x100 0x100>;
        mediatek,sysctl = <&sysc>;
        mt7621,register-reset-handler;
    };
```

## linux/Documentation/devicetree/bindings/watchdog/mt7621-wdt.txt
```
Ralink Watchdog Timers

Required properties:
- compatible: must be "mediatek,mt7621-wdt"
- reg: physical base address of the controller and length of the register range

Optional properties:
- mt7621,register-reset-handler: If property is present, watchdog timer will be
				 registered as reset handler

Example:

	watchdog@100 {
		compatible = "mediatek,mt7621-wdt";
		reg = <0x100 0x10>;
		mt7621,register-reset-handler;
	};
```

## linux/arch/arm/mach-ksz8692/Kconfig
```kconfig
config ARCH_KSZ8692P
	bool

choice
	prompt "Micrel Pegasus Implementations"
	depends on PEGASUS
	default MACH_KSZ8692P

config MACH_KSZ8692P
	bool "KSZ8692P"
	select ARCH_KSZ8692P
	help
	  Include support for KSZ8692P SoC dev board.

config MACH_ACM500X
        bool "OpenGear ACM500X"
	select ARCH_KSZ8692P
        help
          Say 'Y' here if you want your kernel to support the OpenGear
          ACM500X Advanced Console Servers. See http://www.opengear.com
          for more details.

endchoice

choice
	prompt "KSZ8692P Revisions"
	depends on ARCH_KSZ8692P
	default KSZ8692VA

config KSZ8692VA
	bool "KSZ8692 Rev. A"
	help
	  Support for initial revision KSZ8692P silicon.

config KSZ8692VB
	bool "KSZ8692 Rev. B"
	select GENERIC_TIME
	help
	  Support for later revision KSZ8692P silicon.
endchoice

config KSZ8692VB_CLOCKEVENTS
	bool "Use generic clock events"
	depends on KSZ8692VB
	select GENERIC_CLOCKEVENTS
	help
	  Use generic clock events.  This is required for high resolution
	  timer and tickless system.

config KSZ8692_MII
	bool "Use MII mode"
	depends on KSZ8692VB
	help
	  Use MII mode instead of RGMII.

config DELAYED_TIMER
	bool "Enable delayed timer"
	default n
	depends on ARCH_PEGASUS
	help
	  Enable microsecond timer for delayed tasks.

config U_BOOT_LOADER
	bool "Use U-Boot loader"
	default y
	depends on ARCH_PEGASUS
	help
	  Use U-Boot loader.

config CENTAUR_LOADER_SIZE
	hex "Bootloader size"
	depends on ARCH_PEGASUS
	default "0x10000"
	help
	  This is the maximum size of the bootloader for the Pegasus
	  chips.

config CENTAUR_KERNEL_SIZE
	hex "Kernel size"
	depends on ARCH_PEGASUS
	default "0xE0000"
	help
	  This is the maximum size of the kernel for the Pegasus
	  chips.

config CENTAUR_FS_SIZE
	hex "Filesystem size"
	depends on ARCH_PEGASUS
	default "0x60000"
	help
	  This is the size of the non-volatile filesystem for the
	  Pegasus chips.

config CENTAUR_SPARE_SIZE
	hex "Spare size"
	depends on ARCH_PEGASUS
	default "0x40000"
	help
	  This is the size of the spare space for other uses.

choice
	prompt "DDR memory types"
	depends on ARCH_KS8692P
	default MICRON_200_DDR

config SAMSUNG_166_DDR
	bool "Samsung 166 MHz DDR"
	help
	  Support for Samsung 166 MHz DDR chips.

config SAMSUNG_200_DDR
	bool "Samsung 200 MHz DDR"
	help
	  Support for Samsung 200 MHz DDR chips.

config MICRON_166_DDR
	bool "Micron 166 MHz DDR"
	help
	  Support for Micron 166 MHz DDR chips.

config MICRON_200_DDR
	bool "Micron 200 MHz DDR"
	help
	  Support for Micron 200 MHz DDR chips.
endchoice
```

## linux/drivers/bus/mhi_qca/Kconfig
```kconfig
# SPDX-License-Identifier: GPL-2.0
#
# MHI bus
#
# Copyright (c) 2018-2020, The Linux Foundation. All rights reserved.
#

config MHI_QCA_BUS
	tristate "Modem Host Interface (MHI) bus"
	help
	  Bus driver for MHI protocol. Modem Host Interface (MHI) is a
	  communication protocol used by the host processors to control
	  and communicate with modem devices over a high speed peripheral
	  bus or shared memory. Older MHI driver to work with Qualcomm
	  driver for EX50.

config MHI_BUS_DEBUG
	bool "Debugfs support for the MHI bus"
	depends on MHI_BUS && DEBUG_FS
	help
	  Enable debugfs support for use with the MHI transport. Allows
	  reading and/or modifying some values within the MHI controller
	  for debug and test purposes.

config MHI_BUS_PCI_GENERIC
	tristate "MHI PCI controller driver"
	depends on MHI_BUS
	depends on PCI
	help
	  This driver provides MHI PCI controller driver for devices such as
	  Qualcomm SDX55 based PCIe modems.
```

## linux/drivers/net/ethernet/mediatek/Kconfig
```kconfig
config NET_VENDOR_MEDIATEK
	bool "MediaTek ethernet driver"
	depends on ARCH_MEDIATEK || RALINK
	---help---
	  If you have a Mediatek SoC with ethernet, say Y.

config NET_MEDIATEK_SOC
	def_tristate NET_VENDOR_MEDIATEK

if NET_MEDIATEK_SOC
choice
	prompt "MAC type"

config NET_MEDIATEK_MT7620
	bool "MT7620"
	depends on MIPS && SOC_MT7620

config NET_MEDIATEK_MT7621
	bool "MT7621"
	depends on MIPS && SOC_MT7621

config NET_MEDIATEK_MT2701
	bool "MT2701"
	depends on ARM

config NET_MEDIATEK_MT7623
	bool "MT7623"
	depends on ARM

endchoice

config NET_MEDIATEK_MDIO
	def_bool NET_MEDIATEK_SOC
	depends on (NET_MEDIATEK_MT7620 || NET_MEDIATEK_MT7621)
	select PHYLIB

config NET_MEDIATEK_MDIO_MT7620
	def_bool NET_MEDIATEK_SOC
	depends on (NET_MEDIATEK_MT7620 || NET_MEDIATEK_MT7621)
	select NET_MEDIATEK_MDIO

config NET_MEDIATEK_GSW_MT7620
	def_tristate NET_MEDIATEK_SOC
	depends on NET_MEDIATEK_MT7620

config NET_MEDIATEK_GSW_MT7621
	def_tristate NET_MEDIATEK_SOC
	depends on NET_MEDIATEK_MT7621
endif
```
