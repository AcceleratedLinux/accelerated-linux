## lib/libnetfilter_conntrack/Kconfig
```kconfig
config LIB_NETFILTER_CONNTRACK
	bool "libnetfilter_conntrack"
	select LIB_NFNETLINK
	select LIB_LIBMNL
	default n
```

## lib/libnetfilter_cthelper/Kconfig
```kconfig
config LIB_NETFILTER_CTHELPER
	bool "libnetfilter_cthelper"
	select LIB_NFNETLINK
	select LIB_LIBMNL
	default n
```

## lib/libnetfilter_cttimeout/Kconfig
```kconfig
config LIB_NETFILTER_CTTIMEOUT
	bool "libnetfilter_cttimeout"
	select LIB_NFNETLINK
	select LIB_LIBMNL
	default n
```

## lib/libnetfilter_log/Kconfig
```kconfig
config LIB_NETFILTER_LOG
	bool "libnetfilter_log"
	select LIB_NFNETLINK
	select LIB_LIBMNL
	default n
```

## lib/libnetfilter_queue/Kconfig
```kconfig
config LIB_NETFILTER_QUEUE
	bool "libnetfilter_queue"
	select LIB_NFNETLINK
	select LIB_LIBMNL
	default n
```

## lib/libopengear/Kconfig
```kconfig
config LIB_LIBOPENGEAR
	bool "Build libopengear"
	default n
	select LIB_JANSSON
	select LIB_EXPAT
	select LIB_SCEW
	select LIB_LOG4C
	select LIB_ZLIB
	help
	  Opengear console server common function library.
```

## lib/libpam/Kconfig
```kconfig
config LIB_LIBPAM
	bool 'libpam'
	help
	  Build/Install libpam

if LIB_LIBPAM

config LIB_LIBPAM_CONF
	bool "install pam.conf"
	depends on LIB_LIBPAM
	default n
	help
	  Install a default pam.conf

config LIB_LIBPAM_LIBPAMC
	bool "libpamc.so"

config LIB_LIBPAM_LIBPAM_MISC
	bool "libpam_misc.so"

config LIB_LIBPAM_PAM_ACCESS
	bool "pam_access"
	default n
	depends on LIB_LIBPAM
	help
	  PAM module for logdaemon style login access control

config LIB_LIBPAM_PAM_DEBUG
	bool "pam_debug"
	default n
	depends on LIB_LIBPAM
	help
	  PAM module to debug the PAM stack

config LIB_LIBPAM_PAM_DENY
	bool "pam_deny"
	default n
	depends on LIB_LIBPAM
	help
	  The locking-out PAM module

config LIB_LIBPAM_PAM_ECHO
	bool "pam_echo"
	default n
	depends on LIB_LIBPAM
	help
	  PAM module for printing text messages

config LIB_LIBPAM_PAM_ENV
	bool "pam_env"
	default n
	depends on LIB_LIBPAM
	help
	  PAM module to set/unset environment variables

config LIB_LIBPAM_PAM_EXEC
	bool "pam_exec"
	default n
	depends on LIB_LIBPAM
	help
	  PAM module which calls an external command

config LIB_LIBPAM_PAM_FAILDELAY
	bool "pam_faildelay"
	default n
	depends on LIB_LIBPAM
	help
	  Change the delay on failure per-application

config LIB_LIBPAM_PAM_FAILLOCK
	bool "pam_faillock"
	default n
	depends on LIB_LIBPAM
	help
	  Module counting authentication failures during a specified interval

config LIB_LIBPAM_PAM_FILTER
	bool "pam_filter"
	default n
	depends on LIB_LIBPAM
	help
	  PAM filter module

config LIB_LIBPAM_PAM_FTP
	bool "pam_ftp"
	default n
	depends on LIB_LIBPAM
	help
	  PAM module for anonymous access module

config LIB_LIBPAM_PAM_GROUP
	bool "pam_group"
	default n
	depends on LIB_LIBPAM
	help
	  PAM module for group access

config LIB_LIBPAM_PAM_ISSUE
	bool "pam_issue"
	default n
	depends on LIB_LIBPAM
	help
	  PAM module to add issue file to user prompt

config LIB_LIBPAM_PAM_KEYINIT
	bool "pam_keyinit"
	default n
	depends on LIB_LIBPAM
	help
	  Kernel session keyring initialiser module

config LIB_LIBPAM_PAM_LASTLOG
	bool "pam_lastlog"
	default n
	depends on LIB_LIBPAM
	help
	  PAM module to display date of last login and perform inactive account lock out

config LIB_LIBPAM_PAM_LIMITS
	bool "pam_limits"
	default n
	depends on LIB_LIBPAM
	help
	  PAM module to limit resources

config LIB_LIBPAM_PAM_LISTFILE
	bool "pam_listfile"
	default n
	depends on LIB_LIBPAM
	help
	  deny or allow services based on an arbitrary file

config LIB_LIBPAM_PAM_LOCALUSER
	bool "pam_localuser"
	default n
	depends on LIB_LIBPAM
	help
	  require users to be listed in /etc/passwd

config LIB_LIBPAM_PAM_LOGINUID
	bool "pam_loginuid"
	default n
	depends on LIB_LIBPAM
	help
	  Record user's login uid to the process attribute

config LIB_LIBPAM_PAM_MAIL
	bool "pam_mail"
	default n
	depends on LIB_LIBPAM
	help
	  Inform about available mail

config LIB_LIBPAM_PAM_MKHOMEDIR
	bool "pam_mkhomedir"
	default n
	depends on LIB_LIBPAM
	help
	  PAM module to create users home directory

config LIB_LIBPAM_PAM_MOTD
	bool "pam_motd"
	default n
	depends on LIB_LIBPAM
	help
	  Display the motd file

config LIB_LIBPAM_PAM_NAMESPACE
	bool "pam_namespace"
	default n
	depends on LIB_LIBPAM
	help
	  PAM module for configuring namespace for a session

config LIB_LIBPAM_PAM_NOLOGIN
	bool "pam_nologin"
	default n
	depends on LIB_LIBPAM
	help
	  Prevent non-root users from login

config LIB_LIBPAM_PAM_PERMIT
	bool "pam_permit"
	default n
	depends on LIB_LIBPAM
	help
	  The promiscuous module

config LIB_LIBPAM_PAM_PWHISTORY
	bool "pam_pwhistory"
	default n
	depends on LIB_LIBPAM
	help
	  PAM module to remember last passwords

config LIB_LIBPAM_PAM_RHOSTS
	bool "pam_rhosts"
	default n
	depends on LIB_LIBPAM
	help
	  The rhosts PAM module

config LIB_LIBPAM_PAM_ROOTOK
	bool "pam_rootok"
	default n
	depends on LIB_LIBPAM
	help
	  Gain only root access

config LIB_LIBPAM_PAM_SECURETTY
	bool "pam_securetty"
	default n
	depends on LIB_LIBPAM
	help
	  Limit root login to special devices

config LIB_LIBPAM_PAM_SELINUX
	bool "pam_selinux"
	default n
	depends on LIB_LIBPAM
	help
	  PAM module to set the default security context

config LIB_LIBPAM_PAM_SEPERMIT
	bool "pam_sepermit"
	default n
	depends on LIB_LIBPAM
	help
	  PAM module to allow/deny login depending on SELinux enforcement state

config LIB_LIBPAM_PAM_SETQUOTA
	bool "pam_setquota"
	default n
	depends on LIB_LIBPAM
	help
	  PAM module to set or modify disk quotas on session start

config LIB_LIBPAM_PAM_SHELLS
	bool "pam_shells"
	default n
	depends on LIB_LIBPAM
	help
	  PAM module to check for valid login shell

config LIB_LIBPAM_PAM_STRESS
	bool "pam_stress"
	default n
	depends on LIB_LIBPAM
	help
	  The stress-testing PAM module

config LIB_LIBPAM_PAM_SUCCEED_IF
	bool "pam_succeed_if"
	default n
	depends on LIB_LIBPAM
	help
	  test account characteristics

config LIB_LIBPAM_PAM_TIME
	bool "pam_time"
	default n
	depends on LIB_LIBPAM
	help
	  PAM module for time control access

config LIB_LIBPAM_PAM_TIMESTAMP
	bool "pam_timestamp"
	default n
	depends on LIB_LIBPAM
	help
	  Authenticate using cached successful authentication attempts

config LIB_LIBPAM_PAM_TTY_AUDIT
	bool "pam_tty_audit"
	default n
	depends on LIB_LIBPAM
	help
	  Enable or disable TTY auditing for specified users

config LIB_LIBPAM_PAM_UMASK
	bool "pam_umask"
	default n
	depends on LIB_LIBPAM
	help
	  PAM module to set the file mode creation mask

config LIB_LIBPAM_PAM_UNIX
	bool "pam_unix"
	default y
	depends on LIB_LIBPAM
	help
	  Module for traditional password authentication

config LIB_LIBPAM_PAM_USERDB
	bool "pam_userdb"
	default n
	depends on LIB_LIBPAM
	help
	  PAM module to authenticate against a db database

config LIB_LIBPAM_PAM_USERTYPE
	bool "pam_usertype"
	default n
	depends on LIB_LIBPAM
	help
	  check if the authenticated user is a system or regular account

config LIB_LIBPAM_PAM_WARN
	bool "pam_warn"
	default n
	depends on LIB_LIBPAM
	help
	  PAM module which logs all PAM items if called

config LIB_LIBPAM_PAM_WHEEL
	bool "pam_wheel"
	default n
	depends on LIB_LIBPAM
	help
	  Only permit root access to members of group wheel

config LIB_LIBPAM_PAM_XAUTH
	bool "pam_xauth"
	default n
	depends on LIB_LIBPAM
	help
	  PAM module to forward xauth keys between users

endif
```

## lib/libpciaccess/Kconfig
```kconfig
config LIB_LIBPCIACCESS
	bool "Build libpciaccess"
	default n
	help
	  The libpciaccess package contains a library for portable PCI access routines
		across multiple operating systems.
```

## lib/libssl/Kconfig
```kconfig
config LIB_LIBSSL
	bool "Build libSSL"
	default n
	help
		SSL library.
		Only enable this if you want to force the library to be built.
		The Config will make sure this library is built if it is needed.

config LIB_LIBSSL_FIPS
	bool "Build libSSL with FIPs"
	default n
	depends on LIB_LIBSSL
	help
		Build OpenSSL for use with the openssl FIPs certification.
```

## lib/libxcrypt/Kconfig
```kconfig
config LIB_LIBXCRYPT
	bool "libxcrypt"
	select LIBC_NOCRYPT
	help
		libxcrypt is a modern library for one-way hashing of passwords.
		It supports a wide variety of both modern and historical hashing methods.
		It provides the traditional Unix crypt and crypt_r interfaces, as well
		as a set of extended interfaces pioneered by Openwall Linux.
```

## lib/libyang/Kconfig
```kconfig
config LIB_LIBYANG
	bool "libyang"
	select LIB_LIBPCRE2
	help
		The libyang library.
```

## lib/log4c/Kconfig
```kconfig
config LIB_LOG4C
	bool "Build log4c"
	default n
	select LIB_EXPAT
	help
		Log4c is a library of C for flexible logging to files,
		syslog and other destinations.
```

## lib/lz4/Kconfig
```kconfig
config LIB_LIBLZ4
    bool "liblz4"
    help
        Build and install LZ4 compression library
```

## lib/mDNSResponder/Kconfig
```kconfig
config LIB_MDNSRESPONDER
	bool 'mDNSResponder'
	help
	  Library (libdns_sd.so) and service daemon (mdnsd) for mDNS zeroconf
	  service discovery.

config LIB_MDNSRESPONDER_CLIENTS
	bool 'mDNSResponder example clients'
	depends on LIB_MDNSRESPONDER
	help
	  Build package example clients that communicate with mdns (dns-sd utility).

config LIB_MDNSRESPONDER_EMBED
	bool 'mDNSResponder embedded service library'
	depends on LIB_MDNSRESPONDER
	help
	  Build library used by mDNS service applications exposing the mDNSEmbeddedAPI.
```

## lib/minirl/Kconfig
```kconfig
config LIB_MINIRL
    bool "minirl"
    help
        Basic 'readline' alternative
        Functionally equivalent to tinyrl
```

## lib/ncurses/Kconfig
```kconfig
config LIB_NCURSES
	bool "ncurses library for terminal emulation."
	help
	  Include the ncurses library for interaction with terminal devices.

config LIB_NCURSES_MINIMAL
	bool "Minimal terminfo files only."
	depends on LIB_NCURSES
	help
	  Include only a minimal set of terminfo files (vt100 and ansi).
```

## lib/openssl/Kconfig
```kconfig
config LIB_OPENSSL
	bool "Build OpenSSL"
	default n
	help
		OpenSSL library.
		Only enable this if you want to force the library to be built.
		The config will make sure this library is built if it is needed.

config LIB_OPENSSL3
	bool "Build OpenSSL-3.0"
	default n
	depends on LIB_OPENSSL
	help
		Build OpenSSL version 3.0 instead of the legacy version 1.1.

config LIB_OPENSSL_FIPS
	bool "Enable FIPS mode"
	default n
	depends on LIB_OPENSSL3
	help
		Build OpenSSL with FIPS mode enabled.
```

## lib/pcre/Kconfig
```kconfig
config LIB_LIBPCRE
	bool "PCRE"
	default n
	help
	  Perl Compatible Regular Expressions library.
```

## lib/pcre2/Kconfig
```kconfig
config LIB_PCRE2
	bool "PCRE2"
	default n
	help
	  Perl Compatible Regular Expressions library.
```

## lib/protobuf-c/Kconfig
```kconfig
config LIB_PROTOBUF_C
	bool "protobuf-c"
	select LIB_PROTOBUF
	select LIB_PROTOBUF_HOST
	help
		The protobuf-c library.

config LIB_PROTOBUF_C_HOST
	bool "protobuf-c-Host"
	select LIB_PROTOBUF
	select LIB_PROTOBUF_HOST
	help
		The protoc-c host binary.
```

## lib/protobuf/Kconfig
```kconfig
config LIB_PROTOBUF
	bool "libprotobuf"
	select LIB_PROTOBUF_HOST
	help
		The libprotobuf library.

config LIB_PROTOBUF_HOST
	bool "libprotobuf-host"
	help
		The protoc host binary.
```
