## user/conntrack-tools/Kconfig
```kconfig
config USER_CONNTRACK_CONNTRACK
	bool "conntrack"
	select LIB_LIBMNL
	select LIB_NFNETLINK
	select LIB_NETFILTER_CONNTRACK
	select LIB_NETFILTER_CTTIMEOUT
	select LIB_NETFILTER_CTHELPER
	select LIB_NETFILTER_QUEUE
	help
	  Conntrack is a tool for listing and modifying the netfilter
	  conntrack table.
```

## user/crda/Kconfig
```kconfig
config USER_CRDA
	bool "crda"
	select USER_CRDA_REGDB
	help
	  CRDA acts as the udev helper for communication between the kernel and
	  userspace for regulatory compliance for 802.11 WiFi.

config USER_CRDA_REGDB
	bool "wireless-regdb"
	help
	  Wireless regulatory database.

	  Since linux-4.15 the kernel supports loading the files
	  regulatory.db/regulatory.db.p7s directly from the /lib/firmware
	  directory, for earlier versions the crda helper application
	  is needed.

	  https://wireless.wiki.kernel.org/en/developers/regulatory/wireless-regdb

config USER_CRDA_REGDB_UNRESTRICTED_WORLD
	bool "Unrestricted world regulatory domain"
	depends on USER_CRDA_REGDB
	help
	  Rebuild the wireless-regdb's regulatory.bin with an unrestricted "00"
	  world regulatory domain. This domain is usually the most restrictive.
	  The new regulatory.bin file will be signed with an automatically
	  generated public/private key pair rather than by the wireless-regdb's
	  maintainer.
```

## user/cryptsetup/Kconfig
```kconfig
config USER_CRYPTSETUP
	bool "cryptsetup"
	select LIB_LIBDEVMAPPER
	select LIB_LIBARGON2
	help
	  Setup cryptographic volumes for dm-crypt (including LUKS extension)
```

## user/dhcp-isc/Kconfig
```kconfig
config USER_DHCP_ISC
	bool

config USER_DHCP_ISC_SERVER_DHCPD
	bool "dhcpd (ISC)"
	select USER_DHCP_ISC
	help
	  A full featured DHCP daemon that can do almost anything.

config USER_DHCP_ISC_DHCPCTL_OMSHELL
	bool "omshell (ISC)"
	select USER_DHCP_ISC
	depends on USER_DHCP_ISC_SERVER_DHCPD
	help
	  A tool to control dhcp-isc server (dhcpd).

config USER_DHCP_ISC_CLIENT_DHCLIENT
	bool "dhclient (ISC)"
	select USER_DHCP_ISC
	help
	  A DHCP client daemon that supports most everything.

config USER_DHCP_ISC_RELAY_DHCRELAY
	bool "dhcrelay (ISC)"
	select USER_DHCP_ISC
	help
	  A DHCP relay daemon.
```

## user/dropbear/Kconfig
```kconfig
config USER_DROPBEAR_DROPBEAR
	depends on USER_INETD_INETD || USER_BUSYBOX_INETD
	select LIB_ZLIB
	bool "dropbear"
	help
		small SSH server invoked from inetd

config USER_DROPBEAR_DROPBEARCONVERT
	depends on USER_DROPBEAR_DROPBEAR
	bool "dropbearconvert"
	help
		key conversion tools

config USER_DROPBEAR_DROPBEARKEY
	depends on USER_DROPBEAR_DROPBEAR
	bool "dropbearkey"
	help
		key conversion tools

config USER_DROPBEAR_DBCLIENT
	depends on USER_DROPBEAR_DROPBEAR
	bool "dbclient"
	help
		small SSH client
```

## user/e2fsprogs/Kconfig
```kconfig
config USER_E2FSPROGS
	bool "e2fsprogs"
	help
	  The e2fsprogs package contains tools for creating and configuring
	  ext2/ext3/ext4 filesystems.

config USER_E2FSPROGS_BADBLOCKS
	bool "badblocks"
	depends on USER_E2FSPROGS
	help
	  A filesystem tool.

config USER_E2FSPROGS_BLKID
	bool "blkid"
	depends on USER_E2FSPROGS
	help
	  A filesystem tool.

config USER_E2FSPROGS_CHATTR
	bool "chattr"
	depends on USER_E2FSPROGS
	help
	  A filesystem tool.

config USER_E2FSPROGS_DEBUGFS
	bool "debugfs"
	depends on USER_E2FSPROGS
	help
	  A filesystem tool.

config USER_E2FSPROGS_DUMPE2FS
	bool "dumpe2fs"
	depends on USER_E2FSPROGS
	help
	  A filesystem tool.

config USER_E2FSPROGS_E2FREEFRAG
	bool "e2freefrag"
	depends on USER_E2FSPROGS
	help
	  A filesystem tool.

config USER_E2FSPROGS_E2FSCK
	bool "e2fsck"
	depends on USER_E2FSPROGS
	help
	  E2fsck is a tool for checking and repairing damaged filesystems.

config USER_E2FSPROGS_E2IMAGE
	bool "e2image"
	depends on USER_E2FSPROGS
	help
	  A filesystem tool.

config USER_E2FSPROGS_E2LABEL
	bool "e2label"
	depends on USER_E2FSPROGS
	help
	  A filesystem tool.

config USER_E2FSPROGS_E2UNDO
	bool "e2undo"
	depends on USER_E2FSPROGS
	help
	  A filesystem tool.

config USER_E2FSPROGS_FILEFRAG
	bool "filefrag"
	depends on USER_E2FSPROGS
	help
	  A filesystem tool.

config USER_E2FSPROGS_FINDFS
	bool "findfs"
	depends on USER_E2FSPROGS
	help
	  A filesystem tool.

config USER_E2FSPROGS_FSCK
	bool "fsck"
	depends on USER_E2FSPROGS
	help
	  Fsck is a catchall tool used for checking and repairing damaged
	  filesystems. It will call filesystem sub-tools to do the real work.

config USER_E2FSPROGS_FSCK_EXT2
	bool "fsck.ext2"
	depends on USER_E2FSPROGS
	help
	  A tool to check and repair ext2 filesystems.

config USER_E2FSPROGS_FSCK_EXT3
	bool "fsck.ext3"
	depends on USER_E2FSPROGS
	help
	  A tool to check and repair ext3 filesystems.

config USER_E2FSPROGS_FSCK_EXT4
	bool "fsck.ext4"
	depends on USER_E2FSPROGS
	help
	  A tool to check and repair ext4 filesystems.

config USER_E2FSPROGS_LOGSAVE
	bool "logsave"
	depends on USER_E2FSPROGS
	help
	  A filesystem tool.

config USER_E2FSPROGS_LSATTR
	bool "lsattr"
	depends on USER_E2FSPROGS
	help
	  A filesystem tool.

config USER_E2FSPROGS_MKE2FS
	bool "mke2fs"
	depends on USER_E2FSPROGS
	help
	  A tool for creating ext2/ext3/ext4 filesystems.

config USER_E2FSPROGS_MKFS_EXT2
	bool "mkfs.ext2"
	depends on USER_E2FSPROGS
	help
	  A tool for creating ext2 filesystems.

config USER_E2FSPROGS_MKFS_EXT3
	bool "mkfs.ext3"
	depends on USER_E2FSPROGS
	help
	  A tool for creating ext3 filesystems.

config USER_E2FSPROGS_MKFS_EXT4
	bool "mkfs.ext4"
	depends on USER_E2FSPROGS
	help
	  A tool for creating ext4 filesystems.

config USER_E2FSPROGS_MKLOST_FOUND
	bool "mklost+found"
	depends on USER_E2FSPROGS
	help
	  A filesystem tool.

config USER_E2FSPROGS_RESIZE2FS
	bool "resize2fs"
	depends on USER_E2FSPROGS
	help
	  A filesystem tool.

config USER_E2FSPROGS_TUNE2FS
	bool "tune2fs"
	depends on USER_E2FSPROGS
	help
	  A filesystem tool.

config USER_E2FSPROGS_UUIDD
	bool "uuidd"
	depends on USER_E2FSPROGS
	depends on !USER_UTIL_LINUX_LIBUUID
	help
	  A filesystem tool.

config USER_E2FSPROGS_UUIDGEN
	bool "uuidgen"
	depends on USER_E2FSPROGS
	depends on !USER_UTIL_LINUX_LIBUUID
	help
	  A filesystem tool.

config USER_E2FSPROGS_E4CRYPT
	bool "e4crypt"
	depends on USER_E2FSPROGS
	help
	  A filesystem tool to support linux kernel fscrypt management.
```

## user/edgex/Kconfig
```kconfig
config USER_EDGEX
       bool "edgex"
       select LIB_ZEROMQ
       select USER_REDIS
       help
         EdgeX Foundry is a open source platform for the IoT Edge

         https://www.edgexfoundry.org/

         This option installs the GO implementation of EdgeX Foundry microservices
```

## user/ethtool/Kconfig
```kconfig
config USER_ETHTOOL_ETHTOOL
	bool "ethtool"
	help
	  ethtool is a small utility for examining and tuning your
	  ethernet-based network interface. (80k+)

config USER_ETHTOOL_PRETTY_DUMP
	bool "enable registers, EEPROM and SFP pretty dumps"
	default n
	depends on USER_ETHTOOL_ETHTOOL
	help
	  Adds approximately 200kB to the ethtool binary
```

## user/exfat-utils/Kconfig
```kconfig
config USER_EXFAT_UTILS
	bool "EX Fat utilities"
	help
		Enable tools for formatting EX Fat partitions
```

## user/frrouting/Kconfig
```kconfig
config USER_FRROUTING
	bool
	select USER_PYTHON_HOST
	select USER_READLINE
	select LIB_NCURSES
	select LIB_NCURSES_MINIMAL
	select LIB_LIBCARES
	select LIB_LIBCAP
	select LIB_LIBYANG
	select LIB_PROTOBUF_C
	select LIB_PROTOBUF_C_HOST
	help
		For automake build directory inclusion only. Enable USER_FRROUTING_ZEBRA
		for FRRouting.

config USER_FRROUTING_ZEBRA
	bool "FRRouting"
	select USER_FRROUTING
	help
		The FRRouting (GNU Zebra replacement) routing daemon server process.

config USER_FRROUTING_BGPD
	bool "frrouting-bgpd"
	depends on USER_FRROUTING_ZEBRA
	help
		The FRRouting BGP daemon.

config USER_FRROUTING_ISISD
	bool "frrouting-isisd"
	depends on USER_FRROUTING_ZEBRA
	help
		The FRRouting ISIS daemon.

config USER_FRROUTING_OSPFD
	bool "frrouting-ospfd"
	depends on USER_FRROUTING_ZEBRA
	help
		The FRRouting OSPF daemon.

config USER_FRROUTING_OSPF6D
	bool "frrouting-ospf6d"
	depends on USER_FRROUTING_ZEBRA
	help
		The FRRouting OSPF6 daemon.

config USER_FRROUTING_RIPD
	bool "frrouting-ripd"
	depends on USER_FRROUTING_ZEBRA
	help
		The FRRouting RIP daemon.

config USER_FRROUTING_RIPNGD
	bool "frrouting-ripngd"
	depends on USER_FRROUTING_ZEBRA
	help
		The FRRouting RIPng daemon.

config USER_FRROUTING_NHRPD
	bool "frrouting-nhrpd"
	help
		The FRRouting Next Hop Resolution Protocol daemon.
```

## user/gdb/Kconfig
```kconfig
config USER_GDB
	bool "GDB (GNU debugger)"
	default n

if USER_GDB

  config USER_GDB_HOST
	bool "gdb (host)"
	default n
	help
	  Builds tools/$(ARCH)-gdb with minimal features.
	  (Not recommended: You will probably find that your
	  distro's gdb-multiarch package has better features
	  than this configuration.)

  config USER_GDB_TARGET
	bool "gdb (target)"
	default n
	help
	  On-target debugger with minimal features.

  config USER_GDB_GDBSERVER
	bool "gdbserver"
	help
	  Support for remote debugging of a target process.

  config USER_GDB_GCORE
	bool "gcore"
	default n
	select USER_GDB_TARGET
	help
	  A tool to capture a core dump of a live process.
	  It is a wrapper around gdb.

endif
```

## user/gpsd/Kconfig
```kconfig
config USER_GPSD
	bool "gpsd"
	help
	  gpsd

config USER_GPSD_PYTHON_PACKAGE
	bool "gpsd Python packages"
	depends on USER_GPSD
	depends on USER_PYTHON

config USER_GPSD_UBXTOOL
	bool "gpsd's ubxtool"
	depends on USER_GPSD_PYTHON_PACKAGE
	depends on USER_PYTHON_MODULES_PYSERIAL
	help
	  ubxtool to communicate directly with u-blox GPS modules.
```

## user/grub/Kconfig
```kconfig
config USER_GRUB
	bool 'GRUB'
	help
	  GRUB (GRand Unified Bootloader) package.

config USER_GRUB_EFI
	bool 'efi'
	depends on USER_GRUB
	help
	  Build efi extensions into grub

config USER_GRUB_ENVTOOLS
	bool 'fw_printenv/fw_setenv'
	depends on USER_GRUB
	help
	  Install uboot-envtool fw_printenv and fw_setenv emulation wrappers.

config USER_GRUB_DISABLE_VGA_CONSOLE
	bool 'Disable VGA console'
	depends on USER_GRUB
	help
	  Disable VGA console in GRUB
```
