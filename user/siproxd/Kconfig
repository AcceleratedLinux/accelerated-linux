## user/siproxd/Kconfig
```kconfig
config USER_SIPROXD_SIPROXD
	bool "siproxd"
	select LIB_OSIP2
	help
	  siproxd is a SIP proxy. See http://siproxd.sourceforge.net/
```

## user/snort/Kconfig
```kconfig
config USER_SNORT_SNORT
	bool "snort"
	select LIB_DAQ
	select LIB_LIBPCRE
	select LIB_LIBDNET
	help
	  Snort is a network intrusion detection system.  It is capable of
	  performing real-time traffic analysis and packet logging on IP
	  networks.  It can perform protocol analysis, content searching and
	  can be used to detect a variety of attacks and probes, such as
	  buffer overflows, stealth port scans, CGI attacks, SMB probes,
	  OS fingerprinting attempts and much more.
```

## user/squashfs-tools-ng/Kconfig
```kconfig
config USER_SQUASHFS_TOOLS_NG
	bool "Build squashfs-tools-ng"
	default n
	select LIB_XZ
	help
	  New set of tools and libraries for working with SquashFS images.
	  Selecting this only builds and installs the libsquashfs library.

config USER_SQUASHFS_TOOLS_NG_TOOLS
	bool "Build Squashfs tools"
	default n
	help
	  Build Squashfs tool as well.
```

## user/sscep/Kconfig
```kconfig
config USER_SCEP_CLIENT
	bool "SCEP client support"
	help
		Enable SCEP (Simple Certificate Enrollment Protocol) client to securely download private keys and certificates
		from a SCEP server.
```

## user/sysklogd/Kconfig
```kconfig
config USER_SYSKLOGD
	bool "sysklogd"
	default n
	help
	  Standard linux syslog daemon.

config USER_SYSKLOGD_LOG_PRIORITY
	bool "sysklogd log priority"
	depends on USER_SYSKLOGD
	default n
	help
	  Log the priority of each syslog line.
```

## user/tcl/Kconfig
```kconfig
config USER_TCL
	bool "tcl"
	default n
	help
	  TCL (Tool Command Language) is a simple textual language.

config USER_TCL_STATIC
	bool "tcl static"
	depends on USER_TCL
	default n
	help
	  Build non-shared tcl/libtcl

config USER_TCL_LIBTCL_ONLY
	bool "libtcl only"
	depends on USER_TCL
	default n
	help
	  Only build/install the libtcl library

config USER_TCL_INSTALL_ENCODINGS
	bool "tcl character encodings"
	depends on USER_TCL
	default n
	help
	  Install encoding files for TCL. If your programs use
	  various tcl character recoding functions you should
	  choose Y here.
```

## user/trace-cmd/Kconfig
```kconfig
config USER_TRACECMD
  bool "trace-cmd"
  help
	 trace-cmd is the cli front end of ftrace.
```

## user/traceroute/Kconfig
```kconfig
config USER_TRACEROUTE_TRACEROUTE
	bool "traceroute"
	help
	  A tool for tracing the route packets take on the network.
```

## user/transmission/Kconfig
```kconfig
config USER_TRANSMISSION_DAEMON
	bool "Transmission daemon"
	select LIB_LIBEVENT
	select LIB_ZLIB
	select LIB_LIBSSL
	help
		Transmission is a daemon-based Transmission session that can be controlled
		via RPC commands from transmission's web interface or transmission-remote.

config USER_TRANSMISSION_CLI
	bool "Transmission CLI"
	select LIB_LIBEVENT
	select LIB_ZLIB
	select LIB_LIBSSL
	help
		transmission-cli is a lightweight, command-line BitTorrent client with
		scripting capabilities.

config USER_TRANSMISSION_LIGHTWEIGHT
	bool "Optimize Transmission for low-resource systems"
	depends on USER_TRANSMISSION_DAEMON || USER_TRANSMISSION_CLI
	help
		Optimize libtransmission for low-resource systems: smaller cache size,
		prefer unencrypted peer connections, etc.
```

## user/usbip/Kconfig
```kconfig
config USER_USBIP_USBIP
	bool "usbip"
	help
	  Tool to connect to a remote USB device shared by usbipd.
	  Requires kernel modules from USBIP_VHCI_HCD option.

config USER_USBIP_USBIPD
	bool "usbipd"
	help
	  Tool to share a local USB device over the network.
	  This daemon is a listening server.
	  Requires kernel modules from USBIP_HOST option.
```

## user/util-linux/Kconfig
```kconfig
config USER_UTIL_LINUX
	bool "Build util-linux"
	default n
	help
	  util-linux is a collection of all things better served by busybox
	  in most cases

config USER_UTIL_LINUX_LIBBLKID
	bool "libblkid"
	depends on USER_UTIL_LINUX
	default n
	help
	  libblkid

config USER_UTIL_LINUX_LIBUUID
	bool "libuuid"
	depends on USER_UTIL_LINUX
	default n
	help
	  libuuid

config USER_UTIL_LINUX_UUIDD
	bool "uuidd"
	depends on USER_UTIL_LINUX_LIBUUID
	default n
	help
	  uuidd

config USER_UTIL_LINUX_LIBMOUNT
	bool "libmount"
	depends on USER_UTIL_LINUX
	default n
	help
	  libmount

config USER_UTIL_LINUX_FALLOCATE
	bool "fallocate"
	depends on USER_UTIL_LINUX
	default n
	help
	  fallocate

config USER_UTIL_LINUX_LOSETUP
	bool "losetup"
	depends on USER_UTIL_LINUX
	default n
	help
	  losetup

config USER_UTIL_LINUX_FSTRIM
	bool "fstrim"
	depends on USER_UTIL_LINUX
	select USER_UTIL_LINUX_LIBMOUNT
	default n
	help
	  fstrim

config USER_UTIL_LINUX_SWITCH_ROOT
	bool "switch_root"
	depends on USER_UTIL_LINUX
	default n
	help
	  switch_root
```

## user/valgrind/Kconfig
```kconfig
config USER_VALGRIND
    bool "valgrind"
    help
      Memory leak checker.

if USER_VALGRIND

config USER_VALGRIND_CACHEGRIND
    bool "cachegrind"
    help
      Cachegrind is a cache and branch-prediction profiler.
      It helps you make your programs run faster.

config USER_VALGRIND_CALLGRIND
    bool "callgrind"
    help
      Callgrind is a call-graph generating cache profiler.
      It has some overlap with Cachegrind, but also gathers
      some information that Cachegrind does not.

config USER_VALGRIND_DHAT
    bool "dhat"
    help
      DHAT is a different kind of heap profiler.
      It helps you understand issues of block lifetimes,
      block utilisation, and layout inefficiencies.

config USER_VALGRIND_DRD
    bool "drd"
    help
      DRD is also a thread error detector.
      It is similar to Helgrind but uses different analysis
      techniques and so may find different problems.

config USER_VALGRIND_HELGRIND
    bool "helgrind"
    help
      Helgrind is a thread error detector. It helps you make
      your multi-threaded programs more correct.

config USER_VALGRIND_MASSIF
    bool "massif"
    help
      Massif is a heap profiler. It helps you make your programs
      use less memory.

config USER_VALGRIND_MEMCHECK
    bool "memcheck"
    default y
    help
      Memcheck is a memory error detector. It helps you make your programs,
      particularly those written in C and C++, more correct.

config USER_VALGRIND_DISERVER
    bool "diserver (host)"
    default y
    help
      diserver is a host network server process that serves
      debug address info to a remote, on-target valgrind so that
      valgrind can print source addresses.
      A wrapper script is installed as $ROOTDIR/bin/diserver

config USER_VALGRIND_VGDB
    bool "vgdb"
    help
      A GDB protocol server that can control valgrind.

endif
```

## user/wisun_br/Kconfig
```kconfig
config USER_WISUN_BR
	bool 'Wi-SUN Border Router'
	select LIB_MBEDTLS
	select LIB_LIBNL
	select LIB_LIBCAP
	help
	  Wi-SUN Border Router and related tools
```

## user/wpa_supplicant/Kconfig
```kconfig
config USER_WPA_SUPPLICANT
	bool "wpa_supplicant"
	help
	  Support for advanced wireless encryption standards.

config USER_WPA_PASSPHRASE
	bool "wpa_passphrase"
	help
	  Support for advanced wireless encryption standard config generation.

config USER_WPA_CLI
	bool "wpa_cli"
	depends on USER_WPA_SUPPLICANT
	help
	  Support for advanced wireless encryption standard CLI.
```

## vendors/BananaPi/BPI-R64/bpi-r64.its
```
/dts-v1/;

/ {
	description = "BananaPI/BPI-R64";
	address-cells = <1>;

	images {
		kernel@1 {
			description = "Linux kernel";
			data = /incbin/("kernel");
			type = "kernel";
			arch = "arm64";
			os = "linux";
			compression = "none";
			load = <0x40080000>;
			entry = <0x40080000>;
			hash@2 {
				algo = "sha1";
			};
		};

		ramdisk@1 {
			description = "Linux ramdisk";
			data = /incbin/("rootfs.bin");
			type = "ramdisk";
			arch = "arm64";
			os = "linux";
			compression = "none";
			hash@2 {
				algo = "sha1";
			};
		};

		fdt@1 {
			description = "Flattened Device Tree blob";
			data = /incbin/("mt7622-bananapi-bpi-r64.dtb");
			type = "flat_dt";
			arch = "arm64";
			compression = "none";
			hash@2 {
				algo = "sha1";
			};
		};
	};

	configurations {
		default = "config@1";
		config@1 {
			description = "BananaPI/BPI-R64 image";
			kernel = "kernel@1";
			ramdisk = "ramdisk@1";
			fdt = "fdt@1";
		};
	};
};
```

## vendors/Compex/WPQ618/wpq618.its
```
/dts-v1/;

/ {
	description = "Compex/WPQ618";
	address-cells = <1>;

	images {
		kernel@1 {
			description = "Linux kernel";
			data = /incbin/("kernel");
			type = "kernel";
			arch = "arm64";
			os = "linux";
			compression = "none";
			load = <0x41000000>;
			entry = <0x41000000>;
			hash@2 {
				algo = "sha1";
			};
		};

		ramdisk@1 {
			description = "Linux ramdisk";
			data = /incbin/("rootfs.bin");
			type = "ramdisk";
			arch = "arm64";
			os = "linux";
			compression = "none";
			hash@2 {
				algo = "sha1";
			};
		};

		fdt@1 {
			description = "Flattened Device Tree blob";
			data = /incbin/("ipq6018-cp01-c1.dtb");
			type = "flat_dt";
			arch = "arm64";
			compression = "none";
			hash@2 {
				algo = "sha1";
			};
		};
	};

	configurations {
		default = "config@1";
		config@1 {
			description = "Compex/WPQ618 image";
			kernel = "kernel@1";
			ramdisk = "ramdisk@1";
			fdt = "fdt@1";
		};
	};
};
```

## vendors/Digi/AnywhereUSB24/anywhereusb24.its
```
/dts-v1/;

/ {
	description = "U-Boot fitImage for Digi AnywhereUSB Plus";
	#address-cells = <1>;

	images {
		kernel@1 {
			description = "Linux kernel";
			data = /incbin/("kernel.gz");
			type = "kernel";
			arch = "arm64";
			os = "linux";
			compression = "gzip";
			load = <0x80080000>;
			entry = <0x80080000>;
			hash@1 {
				algo = "sha1";
			};
		};

		fdt@anywhereusb24.dtb {
			description = "Flattened Device Tree blob";
			data = /incbin/("anywhereusb24.dtb");
			type = "flat_dt";
			arch = "arm64";
			compression = "none";
			load = <0x90000000>;
			hash@1 {
				algo = "sha1";
			};
		};
	};

	configurations {
		default = "conf@anywhereusb24.dtb";
		conf@anywhereusb24.dtb {
			description = "1 Linux kernel, FDT blob";
			kernel = "kernel@1";
			fdt = "fdt@anywhereusb24.dtb";
			hash@1 {
				algo = "sha1";
			};
		};
	};
};
```

## vendors/Digi/AnywhereUSB2i/anywhereusb2i.its
```
/dts-v1/;

/ {
	description = "U-Boot fitImage for Digi AnywhereUSB Plus";
	#address-cells = <1>;

	images {
		kernel@1 {
			description = "Linux kernel";
			data = /incbin/("kernel.gz");
			type = "kernel";
			arch = "arm64";
			os = "linux";
			compression = "gzip";
			load = <0x80000000>;
			entry = <0x80000000>;
			hash@1 {
				algo = "sha1";
			};
		};

		fdt@anywhereusb2-industrial.dtb {
			description = "Flattened Device Tree blob";
			data = /incbin/("anywhereusb2-industrial.dtb");
			/*data = /incbin/("fsl-ls1012a-frwy.dtb");*/
			type = "flat_dt";
			arch = "arm64";
			compression = "none";
			load = <0x90000000>;
			hash@1 {
				algo = "sha1";
			};
		};
	};

	configurations {
		default = "conf@anywhereusb2-industrial.dtb";
		conf@anywhereusb2-industrial.dtb {
			description = "1 Linux kernel, FDT blob";
			kernel = "kernel@1";
			fdt = "fdt@anywhereusb2-industrial.dtb";
			/*fdt = "fdt@fsl-ls1012a-frwy.dtb";*/
			hash@1 {
				algo = "sha1";
			};
		};
	};
};
```

## vendors/Digi/AnywhereUSB8/anywhereusb8.its
```
/dts-v1/;

/ {
	description = "U-Boot fitImage for Digi AnywhereUSB Plus";
	#address-cells = <1>;

	images {
		kernel@1 {
			description = "Linux kernel";
			data = /incbin/("kernel.gz");
			type = "kernel";
			arch = "arm64";
			os = "linux";
			compression = "gzip";
			load = <0x80080000>;
			entry = <0x80080000>;
			hash@1 {
				algo = "sha1";
			};
		};

		fdt@anywhereusb8.dtb {
			description = "Flattened Device Tree blob";
			data = /incbin/("anywhereusb8.dtb");
			type = "flat_dt";
			arch = "arm64";
			compression = "none";
			load = <0x90000000>;
			hash@1 {
				algo = "sha1";
			};
		};
	};

	configurations {
		default = "conf@anywhereusb8.dtb";
		conf@anywhereusb8.dtb {
			description = "1 Linux kernel, FDT blob";
			kernel = "kernel@1";
			fdt = "fdt@anywhereusb8.dtb";
			hash@1 {
				algo = "sha1";
			};
		};
	};
};
```

## vendors/Digi/CC93/cc93.its
```
/dts-v1/;

/ {
	description = "Digi/ConnectCore-93";
	#address-cells = <1>;

	images {
		kernel_1 {
			description = "Linux kernel";
			data = /incbin/("kernel.gz");
			type = "kernel";
			arch = "arm64";
			os = "linux";
			compression = "gzip";
			load = <0x46000000>;
			entry = <0x46000000>;
			hash_1 {
				algo = "sha1";
			};
		};

		ramdisk_1 {
			description = "Linux ramdisk";
			data = /incbin/("rootfs.bin");
			type = "ramdisk";
			arch = "arm64";
			os = "linux";
			compression = "none";
			hash_2 {
				algo = "sha1";
			};
		};

		fdt_1 {
			description = "Flattened Device Tree blob";
			data = /incbin/("imx93-cc93-dvk.dtb");
			type = "flat_dt";
			arch = "arm64";
			compression = "none";
			hash_1 {
				algo = "sha1";
			};
		};
	};

	configurations {
		default = "config_cp01-c1";
		config_cp01-c1 {
			description = "Digi/ConnectCore-93 image";
			kernel = "kernel_1";
			ramdisk = "ramdisk_1";
			fdt = "fdt_1";
			hash_1 {
				algo = "sha1";
			};
		};
	};
};
```

## vendors/Digi/ConnectEZ1/connectez1.its
```
/dts-v1/;

/ {
	description = "U-Boot fitImage for Digi ConnectEZ-1";
	#address-cells = <1>;

	images {
		kernel@1 {
			description = "Linux kernel";
			data = /incbin/("kernel.gz");
			type = "kernel";
			arch = "arm64";
			os = "linux";
			compression = "gzip";
			load = <0x80000000>;
			entry = <0x80000000>;
			hash@1 {
				algo = "sha1";
			};
		};

		fdt@connectez1.dtb {
			description = "Flattened Device Tree blob";
			data = /incbin/("connectez1.dtb");
			type = "flat_dt";
			arch = "arm64";
			compression = "none";
			load = <0x84000000>;
			hash@1 {
				algo = "sha1";
			};
		};
	};

	configurations {
		default = "conf@connectez1.dtb";
		conf@connectez1.dtb {
			description = "1 Linux kernel, FDT blob";
			kernel = "kernel@1";
			fdt = "fdt@connectez1.dtb";
			hash@1 {
				algo = "sha1";
			};
		};
	};
};
```
