## user/haserl/Kconfig
```kconfig
config USER_HASERL_HASERL
	bool "haserl"
	help
	  A tiny (<30K) cgi wrapper that uses a UNIX shell to provide
	  PHP-like scripting for dynamic web content. It parses form data
	  placing the data in environment variables. It also supports
	  file-uploads and running as a non-privleged user.
```

## user/hidapi/Kconfig
```kconfig
config USER_HID_API
	bool "hidapi"
	help
		A Simple library for communicating with USB and Bluetooth HID devices.
```

## user/hostapd/Kconfig
```kconfig
config USER_HOSTAPD_HOSTAPD
	bool "hostapd"
	help
	  Support Access Point mode on many common WiFi interfaces.

config USER_HOSTAPD_HOSTAPD_CLI
	bool "hostapd_cli"
	depends on USER_HOSTAPD_HOSTAPD

config USER_HOSTAPD_QCA_EXTENSIONS
	bool "hostapd QCA extensions to nl80211"
	depends on USER_HOSTAPD_HOSTAPD
	help
	  Enable QCA vendor extensions to nl80211.
```

## user/iperf/Kconfig
```kconfig
config USER_IPERF_IPERF
        bool "iperf"
        help
          An application for measuring network performance.
```

## user/iproute2/Kconfig
```kconfig
config USER_IPROUTE2
	bool "iproute2"

if USER_IPROUTE2

config USER_IPROUTE2_IP_IP
	bool "ip"
	help
	  The core app for iproute2.

config USER_IPROUTE2_IP_IFCFG
	bool "ifcfg"
	depends on USER_IPROUTE2_IP_IP
	help
		Simplistic script which replaces ifconfig IP management.
		This script requires advanced shell scripts.

config USER_IPROUTE2_IP_ROUTEF
	bool "routef"
	depends on USER_IPROUTE2_IP_IP
	help
		Flush routes.

config USER_IPROUTE2_IP_ROUTEL
	bool "routel"
	depends on USER_IPROUTE2_IP_IP
	help
		List routes with pretty output format.

config USER_IPROUTE2_IP_RTACCT
	bool "rtacct"
	help
		Network statistics tool.

config USER_IPROUTE2_IP_RTMON
	bool "rtmon"
	help
		Listens to and monitors RTnetlink.

config USER_IPROUTE2_IP_GENL
	bool "genl"
	help
		Generic network utility frontend.

config USER_IPROUTE2_IP_RTPR
	bool "rtpr"
	help
		Replace backslashes with newlinews.
		A trivial shell script which converts backslashes in standard input
		to newlines. It's sole purpose is to be fed with input from ip when
		executed with it's --oneline flag.

config USER_IPROUTE2_BRIDGE
	bool "bridge"
	help
		Show/manipulate bridge addresses and devices.

config USER_IPROUTE2_DEVLINK
	bool "devlink"
	help
		Devlink tool

config USER_IPROUTE2_LNSTAT
	bool "lnstat/rtstat/ctstat"
	help
		Network statistics tools.

config USER_IPROUTE2_SS_SS
	bool "ss"
	help
		Utility to investigate sockets.

config USER_IPROUTE2_TC_TC
	bool "tc"
	help
		Show/manipulate traffic control settings.

endif
```

## user/ipset/Kconfig
```kconfig
config USER_IPSET_IPSET
	bool "ipset"
	help
	  Tool for configuring sets in iptables rules.
```

## user/iptables/Kconfig
```kconfig
config USER_IPTABLES_IPTABLES
	bool "iptables"
	help
	  Iptables is the IP firewall administration tool for 2.4 linux.

config USER_IPTABLES_IP6TABLES
	bool "ip6tables"

config USER_IPTABLES_SHARED
	bool "iptables shared extensions"
	help
	  Build iptables extensions as shared objects instead of statically
	  linking.

config USER_NFTABLES
	bool "enable nftables support"
	default n
	help
	  The nftables are not used by Digi(including Opengear) products yet,
	  they need to be disabled so that matches could be found properly.
```

## user/iputils/Kconfig
```kconfig
config USER_IPUTILS_IPUTILS
	bool "iputils apps"
	help
	  The iputils package of ip utilities :)
	  glibc is recommended.

if USER_IPUTILS_IPUTILS

config USER_IPUTILS_PING
	bool "ping"
	help
	  Send IPv4 ICMP ECHO_REQUEST packets to network hosts.

config USER_IPUTILS_PING6
	bool "ping6"
	depends on USER_IPUTILS_PING
	help
	  Send IPv6 ICMP ECHO_REQUEST packets to network hosts.

config USER_IPUTILS_TRACEROUTE6
	bool "traceroute6"
	help
	  Print the IPv6 route packets take to a network host.

config USER_IPUTILS_RDISC
	bool "rdisc"
	help
	  Client side of the ICMP router discovery protocol.

config USER_IPUTILS_CLOCKDIFF
	bool "clockdiff"
	help
	  Measures the clock difference between the local host and
	  a remote host using either ICMP TIMESTAMP packets or the
	  IP TIMESTAMP option in a ICMP ECHO.

config USER_IPUTILS_TFTPD
	bool "tftpd"
	help
	  IPv4 TFTP server.

config USER_IPUTILS_TRACEPATH
	bool "tracepath"
	help
	  Traces a path to a network host discovering MTU along the way.

config USER_IPUTILS_TRACEPATH6
	bool "tracepath6"
	depends on USER_IPUTILS_TRACEPATH
	help
	  Traces a path to a IPv6 network host discovering MTU
	  along the way.

config USER_IPUTILS_ARPING
	bool "arping"
	help
	  Send ARP REQUEST to a neighbouring host

config USER_IPUTILS_RARPD
	bool "rarpd"
	help
	  Reverse Address Resolution Protocol (RARP) Daemon.

endif
```

## user/iw/Kconfig
```kconfig
config USER_IW
	select LIB_LIBNL
	bool "iw"
	help
		Configuration utility for wireless devices.
		This is a replacement for iwconfig.
```

## user/keepalived/Kconfig
```kconfig
config USER_KEEPALIVED
	bool "keepalived"
	select USER_IPTABLES_SHARED
	default n
	help
	  A High availability and load balancing framework that uses Linux IPVS.

config USER_KEEPALIVED_MINIMAL
	bool "keepalived minimal install"
	depends on USER_KEEPALIVED
	default n
	help
	  Only install the keepalived daemon without its supporting files.
```

## user/kmod/Kconfig
```kconfig
config USER_KMOD
	bool "Build kmod tools (libkmod)"
	default n
	help
	  Module loading tools and libraries

config USER_KMOD_LIBKMOD
	bool "libkmod"
	depends on USER_KMOD
	default n
	help
	  libkmod

config USER_KMOD_TOOLS
	bool "tools (rmmod modprobe ...)"
	depends on USER_KMOD
	default n
	help
	  All kmod tools (in for a penny)
```

## user/libgudev/Kconfig
```kconfig
config USER_LIBGUDEV
	bool "libgudev"
	depends on LIB_GLIB && USER_UDEV
	help
	  A library providing GObject bindings for libudev.
```

## user/libqmi/Kconfig
```kconfig
config USER_LIBQMI
	bool 'libqmi'
	help
	  QMI library

config USER_LIBQMI_QMICLI
	bool 'qmicli'
	depends on USER_LIBQMI
	help
	  The qmicli command

config USER_LIBQMI_QMI_NETWORK
	bool 'qmi-network'
	depends on USER_LIBQMI
	help
	  The qmi-network command

config USER_LIBQMI_QMI_FIRMWARE_UPDATE
	bool 'qmi-firmware-update'
	depends on USER_LIBQMI
	help
	  The qmi-firmware-update command
```

## user/libreswan/Kconfig
```kconfig
config USER_LIBRESWAN
	bool "libreswan"
	select LIB_NSS
	select LIB_LIBGMP
	select LIB_LIBCAP_NG
	help
	  Libreswan IPsec tools and files.
	  (Ensure FTW/NFTW/USE_NETLINK/AI_ADDRCONFIG is enabled in your
	  libc config)
```

## user/libvirt/Kconfig
```kconfig
config USER_LIBVIRT
	bool "Build libvirt"
	default n
	select LIB_LIBXML2
	select LIB_LIBPCIACCESS
	select LIB_LIBNL
	select LIB_YAJL
	help
		Libvirt is collection of software that provides a convenient way to manage
		virtual machines and other virtualization functionality.
```

## user/linux-firmware/Kconfig
```kconfig
config USER_LINUX_FIRMWARE
	bool "Include linux firmware."
	help
	  Include firmware for a variety of devices.

config USER_LINUX_FIRMWARE_ALL_FIRMWARE
	bool "Include all firmware."
	depends on USER_LINUX_FIRMWARE
	help
	  Include all firmware on this device.

config USER_LINUX_FIRMWARE_QCA988X
	bool "Firmware for QCA988X."
	depends on USER_LINUX_FIRMWARE && USER_LINUX_FIRMWARE_ALL_FIRMWARE != y
	help
	  Include firmware for the QCA988X ath10k device.

config USER_LINUX_FIRMWARE_QCA988X_CT
	bool "CT firmware for QCA988X."
	depends on USER_LINUX_FIRMWARE_QCA988X || USER_LINUX_FIRMWARE_ALL_FIRMWARE
	help
	  Use CT firmware for the QCA988X ath10k device.

config USER_LINUX_FIRMWARE_QCA9984
	bool "Firmware for QCA9984."
	depends on USER_LINUX_FIRMWARE && USER_LINUX_FIRMWARE_ALL_FIRMWARE != y
	help
	  Include firmware for the QCA9984 ath10k device.

config USER_LINUX_FIRMWARE_QCA9984_CT
	bool "CT firmware for QCA9984."
	depends on USER_LINUX_FIRMWARE_QCA9984 || USER_LINUX_FIRMWARE_ALL_FIRMWARE
	help
	  Use CT firmware for the QCA9984 ath10k device.

config USER_LINUX_FIRMWARE_QCA6174
	bool "Firmware for QCA6174."
	depends on USER_LINUX_FIRMWARE && USER_LINUX_FIRMWARE_ALL_FIRMWARE != y
	help
	  Include firmware for the QCA6174 ath10k device.

config USER_LINUX_FIRMWARE_RT2561
	bool "Firmware for RT2561."
	depends on USER_LINUX_FIRMWARE && USER_LINUX_FIRMWARE_ALL_FIRMWARE != y
	help
	  Include firmware for the RT2561 on the device.

config USER_LINUX_FIRMWARE_RT2661
	bool "Firmware for RT2661."
	depends on USER_LINUX_FIRMWARE && USER_LINUX_FIRMWARE_ALL_FIRMWARE != y
	help
	  Include firmware for the RT2661 on the device.

config USER_LINUX_FIRMWARE_RT2870
	bool "Firmware for RT2870."
	depends on USER_LINUX_FIRMWARE && USER_LINUX_FIRMWARE_ALL_FIRMWARE != y
	help
	  Include firmware for the RT2870 on the device.

config USER_LINUX_FIRMWARE_RT3071
	bool "Firmware for RT3071."
	depends on USER_LINUX_FIRMWARE && USER_LINUX_FIRMWARE_ALL_FIRMWARE != y
	help
	  Include firmware for the RT3071 on the device.

config USER_LINUX_FIRMWARE_RT3290
	bool "Firmware for RT3290."
	depends on USER_LINUX_FIRMWARE && USER_LINUX_FIRMWARE_ALL_FIRMWARE != y
	help
	  Include firmware for the RT3290 on the device.

config USER_LINUX_FIRMWARE_RT2561S
	bool "Firmware for RT2561S."
	depends on USER_LINUX_FIRMWARE && USER_LINUX_FIRMWARE_ALL_FIRMWARE != y
	help
	  Include firmware for the RT2561S on the device.

config USER_LINUX_FIRMWARE_RT2860
	bool "Firmware for RT2860."
	depends on USER_LINUX_FIRMWARE && USER_LINUX_FIRMWARE_ALL_FIRMWARE != y
	help
	  Include firmware for the RT2860 on the device.

config USER_LINUX_FIRMWARE_RT3070
	bool "Firmware for RT3070."
	depends on USER_LINUX_FIRMWARE && USER_LINUX_FIRMWARE_ALL_FIRMWARE != y
	help
	  Include firmware for the RT3070 on the device.

config USER_LINUX_FIRMWARE_RT3090
	bool "Firmware for RT3090."
	depends on USER_LINUX_FIRMWARE && USER_LINUX_FIRMWARE_ALL_FIRMWARE != y
	help
	  Include firmware for the RT3090 on the device.

config USER_LINUX_FIRMWARE_RT73
	bool "Firmware for RT73."
	depends on USER_LINUX_FIRMWARE && USER_LINUX_FIRMWARE_ALL_FIRMWARE != y
	help
	  Include firmware for the RT73 on the device.

config USER_LINUX_FIRMWARE_RTL_NIC
	bool "Firmware for RTL_NIC."
	depends on USER_LINUX_FIRMWARE && USER_LINUX_FIRMWARE_ALL_FIRMWARE != y
	help
	  Include firmware for the RTL_NIC on the device.

config USER_LINUX_FIRMWARE_SDMA_IMX6Q
	bool "Firmware for SDMA_IMX6Q."
	depends on USER_LINUX_FIRMWARE && USER_LINUX_FIRMWARE_ALL_FIRMWARE != y
	help
	  Include firmware for the SDMA_IMX6Q on the device.

config USER_LINUX_FIRMWARE_MT7662
	bool "Firmware for MT7662."
	depends on USER_LINUX_FIRMWARE && USER_LINUX_FIRMWARE_ALL_FIRMWARE != y
	help
	  Include firmware for the MT7662 on the device.

config USER_LINUX_FIRMWARE_MT7662_ROM_PATCH
	bool "Firmware for MT7662_ROM_PATCH."
	depends on USER_LINUX_FIRMWARE && USER_LINUX_FIRMWARE_ALL_FIRMWARE != y
	help
	  Include firmware for the MT7662_ROM_PATCH on the device.

config USER_LINUX_FIRMWARE_MARVELL_SD8887
	bool "Firmware for Marvel SD8887."
	depends on USER_LINUX_FIRMWARE && USER_LINUX_FIRMWARE_ALL_FIRMWARE != y
	help
	  Include firmware for the MARVEL SD8887 on the device.
```

## user/lxc/Kconfig
```kconfig
config USER_LXC
	bool 'lxc'
	select LIB_LIBSECCOMP
	select LIB_LIBCAP
	help
	  Linux containers
```

## user/mobile-broadband-provider-info/Kconfig
```kconfig
config USER_MOBILE_BROADBAND_PROVIDER_INFO
	bool 'mobile-broadband-provider-info'
	help
	  Database of mobile broadband provides and their setups.

choice
	prompt 'mobile-broadband-provider-info install type'
	depends on USER_MOBILE_BROADBAND_PROVIDER_INFO
	default USER_MOBILE_BROADBAND_PROVIDER_INFO_INSTALL_NONE
	help
	  Select installation mode of mobile-broadband-provider-info

config USER_MOBILE_BROADBAND_PROVIDER_INFO_INSTALL_NONE
	bool 'none'
	help
	  Do not install any files

config USER_MOBILE_BROADBAND_PROVIDER_INFO_INSTALL_COMPLETE
	bool 'complete'
	help
	  Install mobile-broadband-provider-info as the creators intended.

config USER_MOBILE_BROADBAND_PROVIDER_INFO_INSTALL_FULL
	bool 'full'
	help
	  Install mobile-broadband-provider-info as a text CSV file,
	  /etc/serviceproviders.txt, containing just the interesting bits.

config USER_MOBILE_BROADBAND_PROVIDER_INFO_INSTALL_PARTIAL
	bool 'partial'
	help
	  Install mobile-broadband-provider-info as a text CSV file,
	  /etc/serviceproviders.txt, containg just the selected countries
	  interesting bits.

endchoice

config USER_MOBILE_BROADBAND_PROVIDER_INFO_INSTALL_AU
	bool 'Australia (au)'
	depends on USER_MOBILE_BROADBAND_PROVIDER_INFO_INSTALL_PARTIAL
	help
      Install "au" entries.

config USER_MOBILE_BROADBAND_PROVIDER_INFO_INSTALL_US
	bool 'USA (us)'
	depends on USER_MOBILE_BROADBAND_PROVIDER_INFO_INSTALL_PARTIAL
	help
      Install "us" entries.

config USER_MOBILE_BROADBAND_PROVIDER_INFO_INSTALL_CA
	bool 'Canada (ca)'
	depends on USER_MOBILE_BROADBAND_PROVIDER_INFO_INSTALL_PARTIAL
	help
      Install "ca" entries.

config USER_MOBILE_BROADBAND_PROVIDER_INFO_INSTALL_UNKNOWN
	bool 'install unknown entries'
	depends on USER_MOBILE_BROADBAND_PROVIDER_INFO && !USER_MOBILE_BROADBAND_PROVIDER_INFO_INSTALL_NONE
	help
	  Sometimes the modem/modem manager fails to determine the providers
	  name and it is set to unknown.  Create unknown entries for all
	  possible APN's as a fallback measure.
```

## user/mosquitto/Kconfig
```kconfig
config USER_MOSQUITTO
       bool "mosquitto"
       help
         Eclipse Mosquitto is an open source (EPL/EDL licensed) message broker
         that implements the MQTT protocol versions 5.0, 3.1.1 and 3.1.

         https://mosquitto.org/
```

## user/nano/Kconfig
```kconfig
config USER_NANO
	bool "nano text editor"
	select LIB_NCURSES
	help
          GNU nano is a text editor for Unix-like computing systems or
          operating environments using a command line interface.
          It emulates the Pico text editor, part of the Pine email client,
          and also provides additional functionality.
          Unlike Pico, nano is licensed under the GNU General Public License (GPL).
```
