## user/qemu/Kconfig
```kconfig
config USER_QEMU
	bool 'QEMU system emulator'
	help
	  QEMU is a system emulator. You may want it for KVM.

config USER_QEMU_AARCH64_SOFTMMU
	bool 'QEMU target aarch64-softmmu'
	depends on USER_QEMU
	help
	  Build the QEMU system target aarch64-softmmu.

config USER_QEMU_AARCH64_LINUX_USER
	bool 'QEMU target aarch64-linux-user'
	depends on USER_QEMU
	help
	  Build the QEMU system target aarch64-linux-user.

config USER_QEMU_ALPHA_SOFTMMU
	bool 'QEMU target alpha-softmmu'
	depends on USER_QEMU
	help
	  Build the QEMU system target alpha-softmmu.

config USER_QEMU_ALPHA_LINUX_USER
	bool 'QEMU target alpha-linux-user'
	depends on USER_QEMU
	help
	  Build the QEMU system target alpha-linux-user.

config USER_QEMU_ARM_SOFTMMU
	bool 'QEMU target arm-softmmu'
	depends on USER_QEMU
	help
	  Build the QEMU system target arm-softmmu.

config USER_QEMU_ARM_LINUX_USER
	bool 'QEMU target arm-linux-user'
	depends on USER_QEMU
	help
	  Build the QEMU system target arm-linux-user.

config USER_QEMU_ARMEB_LINUX_USER
	bool 'QEMU target armeb-linux-user'
	depends on USER_QEMU
	help
	  Build the QEMU system target armeb-linux-user.

config USER_QEMU_CRIS_SOFTMMU
	bool 'QEMU target cris-softmmu'
	depends on USER_QEMU
	help
	  Build the QEMU system target cris-softmmu.

config USER_QEMU_CRIS_LINUX_USER
	bool 'QEMU target cris-linux-user'
	depends on USER_QEMU
	help
	  Build the QEMU system target cris-linux-user.

config USER_QEMU_I386_SOFTMMU
	bool 'QEMU target i386-softmmu'
	depends on USER_QEMU
	help
	  Build the QEMU system target i386-softmmu.

config USER_QEMU_I386_LINUX_USER
	bool 'QEMU target i386-linux-user'
	depends on USER_QEMU
	help
	  Build the QEMU system target i386-linux-user.

config USER_QEMU_LM32_SOFTMMU
	bool 'QEMU target lm32-softmmu'
	depends on USER_QEMU
	help
	  Build the QEMU system target lm32-softmmu.

config USER_QEMU_M68K_SOFTMMU
	bool 'QEMU target m68k-softmmu'
	depends on USER_QEMU
	help
	  Build the QEMU system target m68k-softmmu.

config USER_QEMU_M68K_LINUX_USER
	bool 'QEMU target m68k-linux-user'
	depends on USER_QEMU
	help
	  Build the QEMU system target m68k-linux-user.

config USER_QEMU_MICROBLAZE_SOFTMMU
	bool 'QEMU target microblaze-softmmu'
	depends on USER_QEMU
	help
	  Build the QEMU system target microblaze-softmmu.

config USER_QEMU_MICROBLAZE_LINUX_USER
	bool 'QEMU target microblaze-linux-user'
	depends on USER_QEMU
	help
	  Build the QEMU system target microblaze-linux-user.

config USER_QEMU_MICROBLAZEEL_SOFTMMU
	bool 'QEMU target microblazeel-softmmu'
	depends on USER_QEMU
	help
	  Build the QEMU system target microblazeel-softmmu.

config USER_QEMU_MICROBLAZEEL_INUX_USER
	bool 'QEMU target microblazeel-linux-user'
	depends on USER_QEMU
	help
	  Build the QEMU system target microblazeel-linux-user.

config USER_QEMU_MIPS_SOFTMMU
	bool 'QEMU target mips-softmmu'
	depends on USER_QEMU
	help
	  Build the QEMU system target mips-softmmu.

config USER_QEMU_MIPS_LINUX_USER
	bool 'QEMU target mips-linux-user'
	depends on USER_QEMU
	help
	  Build the QEMU system target mips-linux-user.

config USER_QEMU_MIPSEL_SOFTMMU
	bool 'QEMU target mipsel-softmmu'
	depends on USER_QEMU
	help
	  Build the QEMU system target mipsel-softmmu.

config USER_QEMU_MIPSEL_LINUX_USER
	bool 'QEMU target mipsel-linux-user'
	depends on USER_QEMU
	help
	  Build the QEMU system target mipsel-linux-user.

config USER_QEMU_MIPSN32_LINUX_USER
	bool 'QEMU target mipsn32-linux-user'
	depends on USER_QEMU
	help
	  Build the QEMU system target mipsn32-linux-user.

config USER_QEMU_MIPSN32EL_LINUX_USER
	bool 'QEMU target mipsn32el-linux-user'
	depends on USER_QEMU
	help
	  Build the QEMU system target mipsn32el-linux-user.

config USER_QEMU_MIPS64_SOFTMMU
	bool 'QEMU target mips64-softmmu'
	depends on USER_QEMU
	help
	  Build the QEMU system target mips64-softmmu.

config USER_QEMU_MIPS64_LINUX_USER
	bool 'QEMU target mips64-linux-user'
	depends on USER_QEMU
	help
	  Build the QEMU system target mips64-linux-user.

config USER_QEMU_MIPS64EL_SOFTMMU
	bool 'QEMU target mips64el-softmmu'
	depends on USER_QEMU
	help
	  Build the QEMU system target mips64el-softmmu.

config USER_QEMU_MIPS64EL_LINUX_USER
	bool 'QEMU target mips64el-linux-user'
	depends on USER_QEMU
	help
	  Build the QEMU system target mips64el-linux-user.

config USER_QEMU_MOXIE_SOFTMMU
	bool 'QEMU target moxie-softmmu'
	depends on USER_QEMU
	help
	  Build the QEMU system target moxie-softmmu.

config USER_QEMU_OR32_SOFTMMU
	bool 'QEMU target or32-softmmu'
	depends on USER_QEMU
	help
	  Build the QEMU system target or32-softmmu.

config USER_QEMU_OR32_LINUX_USER
	bool 'QEMU target or32-linux-user'
	depends on USER_QEMU
	help
	  Build the QEMU system target or32-linux-user.

config USER_QEMU_PPC_SOFTMMU
	bool 'QEMU target ppc-softmmu'
	depends on USER_QEMU
	help
	  Build the QEMU system target ppc-softmmu.

config USER_QEMU_PPC_LINUX_USER
	bool 'QEMU target ppc-linux-user'
	depends on USER_QEMU
	help
	  Build the QEMU system target ppc-linux-user.

config USER_QEMU_PPCEMB_SOFTMMU
	bool 'QEMU target ppcemb-softmmu'
	depends on USER_QEMU
	help
	  Build the QEMU system target ppcemb-softmmu.

config USER_QEMU_PPC64_SOFTMMU
	bool 'QEMU target ppc64-softmmu'
	depends on USER_QEMU
	help
	  Build the QEMU system target ppc64-softmmu.

config USER_QEMU_PPC64_LINUX_USER
	bool 'QEMU target ppc64-linux-user'
	depends on USER_QEMU
	help
	  Build the QEMU system target ppc64-linux-user.

config USER_QEMU_PPC64ABI32_LINUX_USER
	bool 'QEMU target ppc64abi32-linux-user'
	depends on USER_QEMU
	help
	  Build the QEMU system target ppc64abi32-linux-user.

config USER_QEMU_PPC64LE_LINUX_USER
	bool 'QEMU target ppc64le-linux-user'
	depends on USER_QEMU
	help
	  Build the QEMU system target ppc64le-linux-user.

config USER_QEMU_S390X_SOFTMMU
	bool 'QEMU target s390x-softmmu'
	depends on USER_QEMU
	help
	  Build the QEMU system target s390x-softmmu.

config USER_QEMU_S390X_LINUX_USER
	bool 'QEMU target s390x-linux-user'
	depends on USER_QEMU
	help
	  Build the QEMU system target s390x-linux-user.

config USER_QEMU_SH4_SOFTMMU
	bool 'QEMU target sh4-softmmu'
	depends on USER_QEMU
	help
	  Build the QEMU system target sh4-softmmu.

config USER_QEMU_SH4_LINUX_USER
	bool 'QEMU target sh4-linux-user'
	depends on USER_QEMU
	help
	  Build the QEMU system target sh4-linux-user.

config USER_QEMU_SH4EB_SOFTMMU
	bool 'QEMU target sh4eb-softmmu'
	depends on USER_QEMU
	help
	  Build the QEMU system target sh4eb-softmmu.

config USER_QEMU_SH4EB_LINUX_USER
	bool 'QEMU target sh4eb-linux-user'
	depends on USER_QEMU
	help
	  Build the QEMU system target sh4eb-linux-user.

config USER_QEMU_SPARC_SOFTMMU
	bool 'QEMU target sparc-softmmu'
	depends on USER_QEMU
	help
	  Build the QEMU system target sparc-softmmu.

config USER_QEMU_SPARC_LINUX_USER
	bool 'QEMU target sparc-linux-user'
	depends on USER_QEMU
	help
	  Build the QEMU system target sparc-linux-user.

config USER_QEMU_SPARC32PLUS_LINUX_USER
	bool 'QEMU target sparc32plus-linux-user'
	depends on USER_QEMU
	help
	  Build the QEMU system target sparc32plus-linux-user.

config USER_QEMU_SPARC64_SOFTMMU
	bool 'QEMU target sparc64-softmmu'
	depends on USER_QEMU
	help
	  Build the QEMU system target sparc64-softmmu.

config USER_QEMU_SPARC64_LINUX_USER
	bool 'QEMU target sparc64-linux-user'
	depends on USER_QEMU
	help
	  Build the QEMU system target sparc64-linux-user.

config USER_QEMU_TRICORE_SOFTMMU
	bool 'QEMU target tricore-softmmu'
	depends on USER_QEMU
	help
	  Build the QEMU system target tricore-softmmu.

config USER_QEMU_UNICORE32_SOFTMMU
	bool 'QEMU target unicore32-softmmu'
	depends on USER_QEMU
	help
	  Build the QEMU system target unicore32-softmmu.

config USER_QEMU_UNICORE32_LINUX_USER
	bool 'QEMU target unicore32-linux-user'
	depends on USER_QEMU
	help
	  Build the QEMU system target unicore32-linux-user.

config USER_QEMU_X86_64_SOFTMMU
	bool 'QEMU target x86_64-softmmu'
	depends on USER_QEMU
	help
	  Build the QEMU system target x86_64-softmmu.

config USER_QEMU_X86_64_LINUX_USER
	bool 'QEMU target x86_64-linux-user'
	depends on USER_QEMU
	help
	  Build the QEMU system target x86_64-linux-user.

config USER_QEMU_XTENSA_SOFTMMU
	bool 'QEMU target xtensa-softmmu'
	depends on USER_QEMU
	help
	  Build the QEMU system target xtensa-softmmu.

config USER_QEMU_XTENSAEB_SOFTMMU
	bool 'QEMU target xtensaeb-softmmu'
	depends on USER_QEMU
	help
	  Build the QEMU system target xtensaeb-softmmu.
```

## user/quagga/Kconfig
```kconfig
config USER_QUAGGA
	bool
	help
		For automake build directory inclusion only. Enable USER_QUAGGA_ZEBRA_ZEBRA
		for Quagga.

config USER_QUAGGA_ZEBRA_ZEBRA
	bool "quagga"
	select USER_QUAGGA
	select LIB_NCURSES
	select LIB_LIBCARES
	help
		The Quagga (unofficial GNU Zebra replacement) routing daemon server
		process.

config USER_QUAGGA_VTYSH_VTYSH
	bool "quagga-vtysh"
	depends on USER_QUAGGA_ZEBRA_ZEBRA
	help
		The Quagga shell.

config USER_QUAGGA_BGPD_BGPD
	bool "quagga-bgpd"
	depends on USER_QUAGGA_ZEBRA_ZEBRA
	help
		The Quagga BGP daemon.

config USER_QUAGGA_OSPFD_OSPFD
	bool "quagga-ospfd"
	depends on USER_QUAGGA_ZEBRA_ZEBRA
	help
		The Quagga OSPF daemon.

config USER_QUAGGA_OSPFAPI
	bool "quagga-ospfapi"
	depends on USER_QUAGGA_ZEBRA_ZEBRA && USER_QUAGGA_OSPFD_OSPFD
	help
		Enables the Quagga OSPFAPI, used to access the OSPF LSA database.

config USER_QUAGGA_OSPFAPI_OSPFCLIENT
	bool "quagga-ospfclient"
	select USER_QUAGGA_OSPFAPI
	depends on USER_QUAGGA_ZEBRA_ZEBRA && USER_QUAGGA_OSPFD_OSPFD
	help
		The Quagga OSPFAPI client program.

config USER_QUAGGA_OSPF6D_OSPF6D
	bool "quagga-ospf6d"
	depends on USER_QUAGGA_ZEBRA_ZEBRA
	help
		The Quagga OSPF6 daemon.

config USER_QUAGGA_RIPD_RIPD
	bool "quagga-ripd"
	depends on USER_QUAGGA_ZEBRA_ZEBRA
	help
		The Quagga RIP daemon.

config USER_QUAGGA_RIPNGD_RIPNGD
	bool "quagga-ripngd"
	depends on USER_QUAGGA_ZEBRA_ZEBRA
	help
		The Quagga RIPNG daemon.

config USER_QUAGGA_ISISD_ISISD
	bool "quagga-isisd"
	depends on USER_QUAGGA_ZEBRA_ZEBRA
	help
		The Quagga ISIS daemon.

config USER_QUAGGA_BABELD_BABELD
	bool "quagga-babeld"
	depends on USER_QUAGGA_ZEBRA_ZEBRA
	help
		The Quagga Babel daemon.

config USER_QUAGGA_PIMD_PIMD
	bool "quagga-pimd"
	depends on USER_QUAGGA_ZEBRA_ZEBRA
	help
		The Quagga PIM (Protocol Independent Multicast) daemon.

config USER_QUAGGA_WATCHQUAGGA_WATCHQUAGGA
	bool "quagga-watchquagga"
	depends on USER_QUAGGA_ZEBRA_ZEBRA
	help
		The Quagga 'watchquagga' utility.
```

## user/readline/Kconfig
```kconfig
config USER_READLINE
	bool 'readline'
	select LIB_TERMCAP
	select LIB_TERMCAP_SHARED
	help
	  readline library
```

## user/redis/Kconfig
```kconfig
config USER_REDIS
       bool "redis"
       help
         Redis is an open source (BSD licensed), in-memory data structure
         store, used as a database, cache and message broker.

         https://redis.io/
```

## user/rsyslog/Kconfig
```kconfig
config USER_RSYSLOG_RSYSLOGD
	bool "rsyslog"
	select LIB_ESTR
	select LIB_FASTJSON
	select USER_UTIL_LINUX
	select USER_UTIL_LINUX_LIBUUID
	select LIB_ZLIB
	help
	  Full featured syslog daemon.
```

## user/samba/Kconfig
```kconfig
config USER_SAMBA
        bool "samba"
	select LIB_LIBNETTLE
	select LIB_GNUTLS
	help
	  Samba is a windows network file sharing tool.

config USER_SAMBA_SMBD
        bool "smbd"
        depends on USER_SAMBA

config USER_SAMBA_NMBD
        bool "nmbd"
        depends on USER_SAMBA

config USER_SAMBA_SMBMOUNT
        bool "smbmount"
        depends on USER_SAMBA

config USER_SAMBA_SMBUMOUNT
        bool "smbumount"
        depends on USER_SAMBA

config USER_SAMBA_MOUNT_CIFS
        bool "mount.cifs"
        depends on USER_SAMBA

config USER_SAMBA_UMOUNT_CIFS
        bool "umount.cifs"
        depends on USER_SAMBA

config USER_SAMBA_SHARED
        bool "uses shared library"
        depends on USER_SAMBA
```

## user/setfset/Kconfig
```kconfig
config USER_SETFSET_SETFSET
	bool "setfset"
	help
	  OpenGear Console Server utility to write boot arguments to flash
```

## user/shadow/Kconfig
```kconfig
config USER_SHADOW_UTILS
	bool "shadow utilities"
	help
	  A collection of shadow password file based utilities.
	  These are generally full featured with lots of flexibility.

if USER_SHADOW_UTILS

config USER_SHADOW_PAM
	bool "use PAM"
	select LIB_LIBPAM
	select LIB_LIBPAM_LIBPAM
	select LIB_LIBPAM_LIBPAM_MISC
	help
	  Instead of using the shadow password file, authentication and session
	  control is managed by PAM the pluggable authentication framework.

config USER_SHADOW_SHAREDLIB
	bool "use shared library"
	help
	  Enabling this option creates a shadow shared library and all the
	  various applications then use this library.  Enabling this option will
	  save space.  The cost of this space saving is the opening of a trivial
	  escalation from normal user privileges to super user ones.  You have
	  been warned.

config USER_SHADOW_CHAGE
	bool "chage"
	help
	  Change user password expiry information.

config USER_SHADOW_CHFN
	bool "chfn"
	help
	  Change real user name and information.

config USER_SHADOW_CHPASSWD
	bool "chpasswd"
	help
	  Update passwords in batch mode.

config USER_SHADOW_CHSH
	bool "chsh"
	help
	  Change login shell.

config USER_SHADOW_EXPIRY
	bool "expiry"
	help
	  Check and enforce password expiration policy.

config USER_SHADOW_FAILLOG
	bool "faillog"
	help
	  Display faillog records or set login failure limits.

config USER_SHADOW_GPASSWD
	bool "gpasswd"
	help
	  Administer the groups file.

config USER_SHADOW_GROUPADD
	bool "groupadd"
	help
	  Create a new group.

config USER_SHADOW_GROUPDEL
	bool "groupdel"
	help
	  Delete a group.

config USER_SHADOW_GROUPMOD
	bool "groupmod"
	help
	  Modify a group.

config USER_SHADOW_GROUPS
	bool "groups"
	help
	  Print the groups a user is in.

config USER_SHADOW_GRPCK
	bool "grpck"
	help
	  Verify integrity of group files.

config USER_SHADOW_GRPCONV
	bool "grpconv"
	help
	  Convert to and from shadow passwords and groups.

config USER_SHADOW_GRPUNCONV
	bool "grpunconv"
	help
	  Convert to and from shadow passwords and groups.

config USER_SHADOW_ID
	bool "id"
	help
	  Print real and effective UIDs and GIDs.

config USER_SHADOW_LASTLOG
	bool "lastlog"
	help
	  Examine the lastlog file.
	  This file contains historic login information.

config USER_SHADOW_LOGIN
	bool "login"
	help
	  The shadow login program.
	  Generally fully featured login program that supports shadow passwords.

config USER_SHADOW_LOGOUTD
	bool "logoutd"
	help
	  Enforce login time restrictions.

config USER_SHADOW_NEWGRP
	bool "newgrp"
	help
	  Log in to a new group.

config USER_SHADOW_NEWUSERS
	bool "newusers"
	help
	  Update and create new users in batch.

config USER_SHADOW_NOLOGIN
	bool "nologin"
	help
	  Politely refuse a login.

config USER_SHADOW_PASSWD
	bool "passwd"
	help
	  The shadow passwd program that complements the shadow login by
	  allowing passwords to be changed.

config USER_SHADOW_PWCK
	bool "pwck"
	help
	  Verify integrity of password files.

config USER_SHADOW_PWCONV
	bool "pwconv"
	help
	  Convert to and from shadow passwords and groups.

config USER_SHADOW_PWUNCONV
	bool "pwunconv"
	help
	  Convert to and from shadow passwords and groups.

config USER_SHADOW_SU
	bool "su"
	help
	  Change user ID or become super-user.

config USER_SHADOW_SULOGIN
	bool "sulogin"
	help
	  Single-user login.

config USER_SHADOW_USERADD
	bool "useradd"
	help
	  Create a new user or update default new user information.

config USER_SHADOW_USERDEL
	bool "userdel"
	help
	  Delete a user account and related files.

config USER_SHADOW_USERMOD
	bool "usermod"
	help
	  Modify a user account.

config USER_SHADOW_VIPW
	bool "vipw"
	help
	  Edit the password, group, shadow-password or shadow-group file.

endif
```
