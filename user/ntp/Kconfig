## user/ntp/Kconfig
```kconfig
config USER_NTP
	bool

config USER_NTP_ENABLE_HARDENFILE
	bool "hardenfile"
	select USER_NTP
	help
	  Enable stack protect all on platforms that support it.

config USER_NTPD_NTPD
	bool "ntpd"
	select USER_NTP
	help
	  Network time protocol daemon version 4.1.1.

config USER_NTPD_NTPDC
	bool "ntpdc"
	select USER_NTP
	help
	  Private mode query program for ntpd.

config USER_NTPD_NTPDATE
	bool "ntpdate"
	select USER_NTP
	help
	  Poll NTP server and set system date.  Part of the NTPD package.

config USER_NTPD_NTPQ
	bool "ntpq"
	select USER_NTP
	help
	  NTP utility.  Part of the NTPD package.

config USER_NTPD_TICKADJ
	bool "tickadj"
	select USER_NTP
	help
	  NTP utility.  Part of the NTPD package.

config USER_NTPD_CALC_TICKADJ
	bool "calc-tickadj"
	select USER_NTP
	help
	  NTP utility.  Part of the NTPD package.

config USER_NTPD_NTP_KEYGEN
	bool "ntp-keygen"
	select USER_NTP
	help
	  NTP utility.  Part of the NTPD package.

config USER_NTPD_NTPTRACE
	bool "ntptrace"
	select USER_NTP
	help
	  NTP utility.  Part of the NTPD package.

config USER_NTPD_SNTP
	bool "sntp"
	select USER_NTP
	help
	  NTP utility.  Part of the NTPD package.

config USER_NTPD_NTP_WAIT
	bool "ntp-wait"
	select USER_NTP
	help
	  NTP utility.  Part of the NTPD package.

config USER_NTPD_UPDATE_LEAP
	bool "update-leap"
	select USER_NTP
	help
	  NTP utility.  Part of the NTPD package.
```

## user/ntpclient/Kconfig
```kconfig
config USER_NTPCLIENT_NTPCLIENT
	bool "ntpclient: ntpclient"
	help
	  Larry Doolittles ntpclient
	  http://doolittle.faludi.com/ntpclient/

config USER_NTPCLIENT_ADJTIMEX
	bool "ntpclient: adjtimex"
	help
	  Larry Doolittles adjtimex
	  http://doolittle.faludi.com/ntpclient/
```

## user/openconnect/Kconfig
```kconfig
config USER_OPENCONNECT
	bool 'openconnect'
	select LIB_LIBXML2
	help
		openconnect client (Cisco anywhereconnect)
```

## user/openvpn/Kconfig
```kconfig
config USER_OPENVPN_OPENVPN
	bool "openvpn"
	select LIB_LIBLZO
	select LIB_LIBLZ4
	select LIB_OPENSSL
	select LIB_LIBCAP_NG
```

## user/ovs/Kconfig
```kconfig
config USER_OVS
	bool 'ovs (Open vSwitch)'
	select LIB_INSTALL_LIBATOMIC
	help
	  Open vSwitch and related tools
```

## user/pam_google_authenticator/Kconfig
```kconfig
config USER_PAM_GOOGLE_AUTHENTICATOR
	bool "PAM Google Authenticator"
	depends on LIB_LIBPAM
	help
	  PAM support for TOTP/HOTP authentication.
```

## user/pam_ldap/Kconfig
```kconfig
config USER_PAM_LDAP
	bool "PAM LDAP"
	depends on LIB_LIBPAM
	select LIB_LIBLDAP
	help
	  PAM support for LDAP authentication.
```

## user/pam_radius/Kconfig
```kconfig
config USER_PAM_RADIUS
	bool "pam_radius"
	depends on LIB_LIBPAM
	select LIB_PAM_GROUPNAME_HELPER
	help
	  Pam radius plugin.
```

## user/pam_tacplus/Kconfig
```kconfig
config USER_PAM_TACACS
	bool "PAM TACACS+"
	depends on LIB_LIBPAM
	select LIB_PAM_GROUPNAME_HELPER
	help
	  PAM should support TACACS authentication.
```

## user/powerman/Kconfig
```kconfig
config USER_POWERMAN_POWERMAN
	bool "powerman"
	help
		Software that controls (remotely and in parallel) switched power
		distribution units.

config USER_POWERMAN_HTTPPOWER
	bool "httppower"
	depends on USER_POWERMAN_POWERMAN
	select LIB_LIBCURL
	default y
	help
		A helper program for powerman which enables it to communicate with
		HTTP based power distribution units.

config USER_POWERMAN_SNMPPOWER
	bool "snmppower"
	depends on USER_POWERMAN_POWERMAN
	depends on USER_NETSNMP_SNMPD && USER_NETSNMP_MIBLOADING && !USER_NETSNMP_BUILDSTATIC
	default y
	help
		A helper program for powerman which enables it to communicate with
		SNMP based power distribution units.
```

## user/procps/Kconfig
```kconfig
config USER_PROCPS
	bool "procps"
	select LIB_NCURSES
	help
	  Procps is a package of system tools often used on Linux systems.
	  They tend to be tools for assisting in managing processes, such
	  as "ps", "kill", "top", etc.

if USER_PROCPS

config USER_PROCPS_FREE
	bool "free"

config USER_PROCPS_KILL
	bool "kill"

config USER_PROCPS_PGREP
	bool "pgrep"

config USER_PROCPS_PIDOF
	bool "pkill"

config USER_PROCPS_PKILL
	bool "pkill"

config USER_PROCPS_PMAP
	bool "pmap"

config USER_PROCPS_PS
	bool "ps"

config USER_PROCPS_PWDX
	bool "pwdx"

config USER_PROCPS_SLABTOP
	bool "slabtop"

config USER_PROCPS_SYSCTL
	bool "sysctl"

config USER_PROCPS_TLOAD
	bool "tload"

config USER_PROCPS_TOP
	bool "top"

config USER_PROCPS_UPTIME
	bool "uptime"

config USER_PROCPS_VMSTAT
	bool "vmstat"

config USER_PROCPS_W
	bool "w"

config USER_PROCPS_WATCH
	bool "watch"

endif
```

## user/python-modules/Kconfig
```kconfig
if USER_PYTHON
menu "python modules"

config USER_PYTHON_MODULES_PIP
	bool "pip"
	select USER_PYTHON_MODULES_SETUPTOOLS
	help
		The PyPA recommended tool for installing Python packages.

config USER_PYTHON_MODULES_SETUPTOOLS_HOST
	bool "setuptools - host build"
	help
		Easily download, build, install, upgrade, and uninstall Python packages.
		Host build only.

config USER_PYTHON_MODULES_SETUPTOOLS
	bool "setuptools - install on target"
	select USER_PYTHON_MODULES_SETUPTOOLS_HOST
	help
		Easily download, build, install, upgrade, and uninstall Python packages.

config USER_PYTHON_MODULES_SIX
	bool "six"
	help
		Python 2 and 3 compatibility utilities.

config USER_PYTHON_MODULES_CFFI
	bool "cffi"
	help
		Foreign Function Interface for Python calling C code.

config USER_PYTHON_MODULES_PYSERIAL
	bool "pyserial"
	help
		Python Serial Port Extension.

config USER_PYTHON_MODULES_PYSERIAL_ASYNCIO
	bool "pyserial-asyncio"
	select USER_PYTHON_MODULES_SETUPTOOLS_HOST
	select USER_PYTHON_MODULES_PYSERIAL
	help
		Async I/O extension package for the Python Serial Port Extension.

config USER_PYTHON_MODULES_PYMODBUS
	bool "pymodbus"
	select USER_PYTHON_MODULES_SETUPTOOLS_HOST
	select USER_PYTHON_MODULES_SIX
	select USER_PYTHON_MODULES_PYSERIAL
	select USER_PYTHON_MODULES_PYSERIAL_ASYNCIO
	help
		Pymodbus is a full Modbus protocol implementation.

config USER_PYTHON_MODULES_BCRYPT
	bool "bcrypt"
	select USER_PYTHON_MODULES_CFFI
	select USER_PYTHON_MODULES_SIX
	help
		Modern password hashing for your software and your servers.

config USER_PYTHON_MODULES_PEXPECT
	bool "pexpect"
	select USER_PYTHON_MODULES_PTYPROCESS
	help
		Pexpect allows easy control of interactive console applications.

config USER_PYTHON_MODULES_PTYPROCESS
	bool "ptyprocess"
	help
		Run a subprocess in a pseudo terminal.

config USER_PYTHON_MODULES_DIGI_XBEE_LIB
	bool "Digi XBee Python library"
	select USER_PYTHON_MODULES_SETUPTOOLS_HOST
	select USER_PYTHON_MODULES_PYSERIAL
	help
		Digi XBee Python library.

config USER_PYTHON_MODULES_AWS_SDK
	bool "AWS SDK Python library"
	help
		AWS SDK Python library.

config USER_PYTHON_MODULES_SRP
	bool "Secure Remote Password protocol (SRP)"
	select USER_PYTHON_MODULES_SIX
	help
		Secure Remote Password protocol (SRP)

config USER_PYTHON_MODULES_PAHO_MQTT
	bool "paho-mqtt"
	select USER_PYTHON_MODULES_SETUPTOOLS_HOST
	help
		Eclipse Paho MQTT Python client library.

config USER_PYTHON_MODULES_HID
	bool "hid"
	select USER_PYTHON_MODULES_SETUPTOOLS_HOST
	select USER_HID_API
	help
		ctypes bindings for hidapi.

config USER_PYTHON_MODULES_PYSOCKS
	bool "PySocks"
	select USER_PYTHON_MODULES_SETUPTOOLS_HOST
	help
		PySocks lets you send traffic through SOCKS proxy servers. It is
		a modern fork of SocksiPy with bug fixes and extra features.

config USER_PYTHON_MODULES_CHARDET
	bool "chardet"
	select USER_PYTHON_MODULES_SETUPTOOLS_HOST
	help
		The Universal Character Encoding Detector.

config USER_PYTHON_MODULES_CERTIFI
	bool "certifi"
	select USER_PYTHON_MODULES_SETUPTOOLS_HOST
	help
		Python SSL Certificates. Certifi provides Mozilla's carefully
		curated collection of Root Certificates for validating the
		trustworthiness of SSL certificates while verifying the identity
		of TLS hosts.

config USER_PYTHON_MODULES_URLLIB3
	bool "urllib3"
	select USER_PYTHON_MODULES_SETUPTOOLS_HOST
	help
		urllib3 is a powerful, sanity-friendly HTTP client for Python.

config USER_PYTHON_MODULES_IDNA
	bool "idna"
	select USER_PYTHON_MODULES_SETUPTOOLS_HOST
	help
		Support for the Internationalised Domain Names in Applications
		(IDNA) protocol as specified in RFC 5891.

config USER_PYTHON_MODULES_REQUESTS
	bool "requests"
	select USER_PYTHON_MODULES_SETUPTOOLS_HOST
	select USER_PYTHON_MODULES_CHARDET
	select USER_PYTHON_MODULES_CERTIFI
	select USER_PYTHON_MODULES_URLLIB3
	select USER_PYTHON_MODULES_IDNA
	help
		Requests is an elegant and simple HTTP library for Python.

config USER_PYTHON_MODULES_REQUESTS_UNIXSOCKET
	bool "requests-unixsocket"
	select USER_PYTHON_MODULES_SETUPTOOLS_HOST
	help
		Use requests to talk HTTP via a UNIX domain socket.

config USER_PYTHON_MODULES_JANUS
	bool "janus"
	select USER_PYTHON_MODULES_SETUPTOOLS_HOST
	help
		Thread-safe asyncio-aware queue for Python.

config USER_PYTHON_MODULES_AZURE_IOT_DEVICE
	bool "six"
	select USER_PYTHON_MODULES_SETUPTOOLS_HOST
	select USER_PYTHON_MODULES_SIX
	select USER_PYTHON_MODULES_PYSOCKS
	select USER_PYTHON_MODULES_REQUESTS
	select USER_PYTHON_MODULES_REQUESTS_UNIXSOCKET
	select USER_PYTHON_MODULES_JANUS
	select USER_PYTHON_MODULES_PAHO_MQTT
	select USER_PYTHON_MODULES_URLLIB3
	help
		The Azure IoTHub Service SDK for Python provides functionality
		for communicating with the Azure IoT Hub.

endmenu
endif
```

## user/python/Kconfig
```kconfig
config USER_PYTHON_HOST
	bool "python-host"
	help
		Build python for the build system,  this is used for
		building python and other python related services throughout
		the build process.

config USER_PYTHON
	bool "python-target"
	depends on LIB_LIBFFI
	select USER_PYTHON_HOST
	help
		Build python for the target device,  requires a host build

config USER_PYTHON_LIVE_IMAGE
	bool "python-target live image"
	depends on LIB_LIBFFI
	select USER_PYTHON
	help
		Build python and create an image that can be
		live-mounted on the target.
```

## user/python2/Kconfig
```kconfig
config USER_PYTHON2_HOST
	bool "python2-host (2.7)"
	help
		Build python2 for the build system,  this is used for
		building python2 and other python2 related services
		throughout the build process.

config USER_PYTHON2
	bool "python2-target (2.7)"
	select LIB_LIBFFI
	select LIB_NCURSES
	select LIB_NCURSES_MINIMAL
	select USER_PYTHON2_HOST
	help
		Build python2 for the target device, requires a host build.
		Note that enabling this option does not include any new files
		into the DAL image, it only builds Python, installs any third-party
		packages (see "python2 modules") and creates an LXC container.


if USER_PYTHON2
menu "python2 modules (2.7)"

# Note that pip was not installed in NDS or DBL.
config USER_PYTHON2_MODULES_PIP
	bool "pip"
	select USER_PYTHON2_MODULES_SETUPTOOLS
	help
		The PyPA recommended tool for installing Python packages.

config USER_PYTHON2_MODULES_SETUPTOOLS_HOST
	bool "setuptools - host build"
	help
		Easily download, build, install, upgrade, and uninstall Python packages.
		Host build only.

config USER_PYTHON2_MODULES_SETUPTOOLS
	bool "setuptools - install on target"
	select USER_PYTHON2_MODULES_SETUPTOOLS_HOST
	help
		Easily download, build, install, upgrade, and uninstall Python packages.

config USER_PYTHON2_MODULES_SIX
	bool "six"
	help
		Python 2 and 3 compatibility utilities.

config USER_PYTHON2_MODULES_PAHO_MQTT
	bool "paho-mqtt"
	select USER_PYTHON2_MODULES_SETUPTOOLS_HOST
	help
		Eclipse Paho MQTT Python client library.

endmenu
endif
```
